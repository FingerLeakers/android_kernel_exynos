/*
 * SAMSUNG EXYNOS9820 board device tree source
 *
 * Copyright (c) 2018 Samsung Electronics Co., Ltd.
 *		http://www.samsung.com
 *
 * This program is free software; you can redistribute it and/or modify
 * it under the terms of the GNU General Public License version 2 as
 * published by the Free Software Foundation.
*/

/dts-v1/;
/plugin/;

/ {
	compatible = "samsung,D2X EUR OPEN 21", "samsung,EXYNOS9820";
	dtbo-hw_rev = <18>;
   	dtbo-hw_rev_end = <255>;
	edtbo-rev = <0>;

	fragment@model {
		target-path = "/";
		__overlay__ {
			#address-cells = <2>;
			#size-cells = <1>;

			model = "Samsung D2X EUR OPEN 21 Extend board based on EXYNOS9820";

		}; /* end of __overlay__ */
	}; /* end of fragment */
}; /* end of root */
