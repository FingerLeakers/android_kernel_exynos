## arch/arm64/configs/exynos9810-base_defconfig
```kconfig
CONFIG_SWAP=y
# CONFIG_FHANDLE is not set
CONFIG_AUDIT=y
CONFIG_NO_HZ=y
CONFIG_HIGH_RES_TIMERS=y
CONFIG_TASKSTATS=y
CONFIG_TASK_DELAY_ACCT=y
CONFIG_TASK_XACCT=y
CONFIG_TASK_IO_ACCOUNTING=y
CONFIG_IKCONFIG=y
CONFIG_IKCONFIG_PROC=y
CONFIG_LOG_BUF_SHIFT=19
CONFIG_CGROUPS=y
CONFIG_CGROUP_DEBUG=y
CONFIG_CGROUP_FREEZER=y
CONFIG_CPUSETS=y
CONFIG_CGROUP_CPUACCT=y
CONFIG_CGROUP_SCHEDTUNE=y
CONFIG_CGROUP_SCHED=y
CONFIG_RT_GROUP_SCHED=y
CONFIG_SCHED_USE_FLUID_RT=y
CONFIG_CGROUP_BPF=y
CONFIG_NAMESPACES=y
CONFIG_SCHED_TUNE=y
CONFIG_SCHED_EHMP=y
CONFIG_DEFAULT_USE_ENERGY_AWARE=y
CONFIG_BLK_DEV_INITRD=y
CONFIG_CC_OPTIMIZE_FOR_SIZE=y
CONFIG_BPF_SYSCALL=y
CONFIG_EMBEDDED=y
# CONFIG_COMPAT_BRK is not set
CONFIG_PROFILING=y
CONFIG_CC_STACKPROTECTOR_STRONG=y
# CONFIG_BLK_DEV_BSG is not set
CONFIG_PARTITION_ADVANCED=y
# CONFIG_IOSCHED_DEADLINE is not set
CONFIG_SOC_EXYNOS9810=y
CONFIG_SOC_EXYNOS9810_EVT1=y
CONFIG_ARCH_EXYNOS9=y
CONFIG_PCI=y
CONFIG_PCI_MSI=y
CONFIG_PCI_EXYNOS=y
CONFIG_EXYNOS_PCIE_IOMMU=y
CONFIG_PCIE_IOMMU_HISTORY_LOG=y
CONFIG_SCHED_MC=y
CONFIG_NR_CPUS=8
CONFIG_PREEMPT=y
CONFIG_KSM=y
CONFIG_ARMV8_DEPRECATED=y
CONFIG_SWP_EMULATION=y
CONFIG_CP15_BARRIER_EMULATION=y
CONFIG_SETEND_EMULATION=y
CONFIG_ARM64_SW_TTBR0_PAN=y
CONFIG_RKP_CFP_JOPP=y
# CONFIG_ARM64_HW_AFDBM is not set
# CONFIG_ARM64_PAN is not set
# CONFIG_ARM64_VHE is not set
# CONFIG_ARM64_UAO is not set
CONFIG_RANDOMIZE_BASE=y
# CONFIG_RELOCATABLE_KERNEL is not set
# CONFIG_EFI is not set
# CONFIG_CORE_DUMP_DEFAULT_ELF_HEADERS is not set
CONFIG_COMPAT=y
CONFIG_PM_AUTOSLEEP=y
CONFIG_PM_WAKELOCKS=y
CONFIG_PM_WAKELOCKS_LIMIT=0
# CONFIG_PM_WAKELOCKS_GC is not set
CONFIG_PM_DEBUG=y
CONFIG_FOTA_LIMIT=y
CONFIG_CPU_IDLE=y
CONFIG_ARM64_EXYNOS_CPUIDLE=y
CONFIG_CPU_FREQ=y
CONFIG_CPU_FREQ_STAT=y
CONFIG_CPU_FREQ_DEFAULT_GOV_SCHEDUTIL=y
# CONFIG_CPU_FREQ_GOV_USERSPACE is not set
# CONFIG_CPU_FREQ_GOV_INTERACTIVE is not set
CONFIG_ARM_EXYNOS_ACME=y
CONFIG_NET=y
CONFIG_PACKET=y
CONFIG_UNIX=y
CONFIG_XFRM_USER=y
CONFIG_NET_KEY=y
CONFIG_INET=y
CONFIG_IP_MULTICAST=y
CONFIG_IP_ADVANCED_ROUTER=y
CONFIG_IP_MULTIPLE_TABLES=y
CONFIG_IP_PNP=y
CONFIG_IP_PNP_DHCP=y
CONFIG_IP_PNP_BOOTP=y
CONFIG_IP_PNP_RARP=y
CONFIG_INET_ESP=y
# CONFIG_INET_XFRM_MODE_BEET is not set
CONFIG_INET_DIAG=y
CONFIG_INET_DIAG_DESTROY=y
CONFIG_TCP_CONG_ADVANCED=y
CONFIG_TCP_CONG_BIC=y
CONFIG_DEFAULT_BIC=y
CONFIG_DEFAULT_TCP_CONG="bic"
CONFIG_IPV6_ROUTER_PREF=y
CONFIG_IPV6_ROUTE_INFO=y
CONFIG_IPV6_OPTIMISTIC_DAD=y
CONFIG_INET6_AH=y
CONFIG_INET6_ESP=y
CONFIG_INET6_IPCOMP=y
CONFIG_IPV6_MIP6=y
CONFIG_IPV6_TUNNEL=y
CONFIG_IPV6_MULTIPLE_TABLES=y
CONFIG_NETFILTER=y
CONFIG_NF_CONNTRACK=y
CONFIG_NF_CONNTRACK_SECMARK=y
CONFIG_NF_CONNTRACK_EVENTS=y
CONFIG_NF_CT_PROTO_DCCP=y
CONFIG_NF_CT_PROTO_SCTP=y
CONFIG_NF_CT_PROTO_UDPLITE=y
CONFIG_NF_CONNTRACK_AMANDA=y
CONFIG_NF_CONNTRACK_FTP=y
CONFIG_NF_CONNTRACK_H323=y
CONFIG_NF_CONNTRACK_IRC=y
CONFIG_NF_CONNTRACK_NETBIOS_NS=y
CONFIG_NF_CONNTRACK_PPTP=y
CONFIG_NF_CONNTRACK_SANE=y
CONFIG_NF_CONNTRACK_TFTP=y
CONFIG_NF_CT_NETLINK=y
CONFIG_NETFILTER_XT_TARGET_CLASSIFY=y
CONFIG_NETFILTER_XT_TARGET_CONNMARK=y
CONFIG_NETFILTER_XT_TARGET_CONNSECMARK=y
CONFIG_NETFILTER_XT_TARGET_CT=y
CONFIG_NETFILTER_XT_TARGET_IDLETIMER=y
CONFIG_NETFILTER_XT_TARGET_LOG=y
CONFIG_NETFILTER_XT_TARGET_MARK=y
CONFIG_NETFILTER_XT_TARGET_NFLOG=y
CONFIG_NETFILTER_XT_TARGET_NFQUEUE=y
CONFIG_NETFILTER_XT_TARGET_TPROXY=y
CONFIG_NETFILTER_XT_TARGET_TRACE=y
CONFIG_NETFILTER_XT_TARGET_SECMARK=y
CONFIG_NETFILTER_XT_TARGET_TCPMSS=y
CONFIG_NETFILTER_XT_MATCH_COMMENT=y
CONFIG_NETFILTER_XT_MATCH_CONNBYTES=y
CONFIG_NETFILTER_XT_MATCH_CONNLABEL=y
CONFIG_NETFILTER_XT_MATCH_CONNLIMIT=y
CONFIG_NETFILTER_XT_MATCH_CONNMARK=y
CONFIG_NETFILTER_XT_MATCH_CONNTRACK=y
CONFIG_NETFILTER_XT_MATCH_HASHLIMIT=y
CONFIG_NETFILTER_XT_MATCH_HELPER=y
CONFIG_NETFILTER_XT_MATCH_IPRANGE=y
CONFIG_NETFILTER_XT_MATCH_LENGTH=y
CONFIG_NETFILTER_XT_MATCH_LIMIT=y
CONFIG_NETFILTER_XT_MATCH_MAC=y
CONFIG_NETFILTER_XT_MATCH_MARK=y
CONFIG_NETFILTER_XT_MATCH_POLICY=y
CONFIG_NETFILTER_XT_MATCH_PKTTYPE=y
CONFIG_NETFILTER_XT_MATCH_QTAGUID=y
CONFIG_NETFILTER_XT_MATCH_QUOTA=y
CONFIG_NETFILTER_XT_MATCH_QUOTA2=y
CONFIG_NETFILTER_XT_MATCH_QUOTA2_LOG=y
CONFIG_NETFILTER_XT_MATCH_SCTP=y
CONFIG_NETFILTER_XT_MATCH_SOCKET=y
CONFIG_NETFILTER_XT_MATCH_STATE=y
CONFIG_NETFILTER_XT_MATCH_STATISTIC=y
CONFIG_NETFILTER_XT_MATCH_STRING=y
CONFIG_NETFILTER_XT_MATCH_TIME=y
CONFIG_NETFILTER_XT_MATCH_U32=y
CONFIG_NF_CONNTRACK_IPV4=y
CONFIG_IP_NF_IPTABLES=y
CONFIG_IP_NF_MATCH_AH=y
CONFIG_IP_NF_MATCH_ECN=y
CONFIG_IP_NF_MATCH_RPFILTER=y
CONFIG_IP_NF_MATCH_TTL=y
CONFIG_IP_NF_FILTER=y
CONFIG_IP_NF_TARGET_REJECT=y
CONFIG_IP_NF_NAT=y
CONFIG_IP_NF_TARGET_MASQUERADE=y
CONFIG_IP_NF_TARGET_NETMAP=y
CONFIG_IP_NF_TARGET_REDIRECT=y
CONFIG_IP_NF_MANGLE=y
CONFIG_IP_NF_RAW=y
CONFIG_IP_NF_SECURITY=y
CONFIG_IP_NF_ARPTABLES=y
CONFIG_IP_NF_ARPFILTER=y
CONFIG_IP_NF_ARP_MANGLE=y
CONFIG_NF_CONNTRACK_IPV6=y
CONFIG_IP6_NF_IPTABLES=y
CONFIG_IP6_NF_MATCH_RPFILTER=y
CONFIG_IP6_NF_FILTER=y
CONFIG_IP6_NF_TARGET_REJECT=y
CONFIG_IP6_NF_MANGLE=y
CONFIG_IP6_NF_RAW=y
CONFIG_IP6_NF_NAT=y
CONFIG_PHONET=y
CONFIG_NET_SCHED=y
CONFIG_NET_SCH_HTB=y
CONFIG_NET_SCH_INGRESS=y
CONFIG_NET_CLS_U32=y
CONFIG_NET_EMATCH=y
CONFIG_NET_EMATCH_U32=y
CONFIG_NET_CLS_ACT=y
CONFIG_NET_ACT_POLICE=y
CONFIG_NET_ACT_GACT=y
CONFIG_NET_ACT_MIRRED=y
CONFIG_UEVENT_HELPER_PATH="/sbin/hotplug"
CONFIG_DEVTMPFS=y
CONFIG_FW_LOADER_USER_HELPER_FALLBACK=y
CONFIG_DMA_CMA=y
CONFIG_CMA_SIZE_MBYTES=26
CONFIG_BLK_DEV_LOOP=y
CONFIG_BLK_DEV_RAM=y
CONFIG_BLK_DEV_RAM_SIZE=8192
CONFIG_UID_SYS_STATS=y
CONFIG_MEMORY_STATE_TIME=y
CONFIG_MCU_IPC=y
CONFIG_SHM_IPC=y
CONFIG_SEC_SIPC_MODEM_IF=y
CONFIG_NF_HISTORY=y
CONFIG_LINK_DEVICE_NAPI=y
CONFIG_MODEM_IF_QOS=y
CONFIG_DEV_RIL_BRIDGE=y
CONFIG_NETFILTER_XT_MATCH_ONESHOT=y
CONFIG_MODEM_IF_NET_GRO=y
CONFIG_VBUS_NOTIFIER=y
CONFIG_USE_MUIC=y
CONFIG_USE_SAFEOUT=y
CONFIG_MUIC_NOTIFIER=y
CONFIG_SCSI=y
CONFIG_UFS_SRPMB=y
CONFIG_BLK_DEV_SD=y
CONFIG_SCSI_UFSHCD=y
CONFIG_SCSI_UFSHCD_PLATFORM=y
CONFIG_SCSI_UFS_EXYNOS=y
CONFIG_SCSI_UFS_CMD_LOGGING=y
CONFIG_SCSI_UFS_ASYNC_RELINK=y
CONFIG_UFS_DATA_LOG=y
CONFIG_UFS_DATA_LOG_MAGIC_CODE=y
CONFIG_MD=y
CONFIG_BLK_DEV_DM=y
CONFIG_DM_CRYPT=y
CONFIG_DM_UEVENT=y
CONFIG_DM_VERITY=y
CONFIG_DM_VERITY_FEC=y
CONFIG_KNOX_KAP=y
CONFIG_NETDEVICES=y
#WiFi
CONFIG_BROADCOM_WIFI=y
CONFIG_NL80211_TESTMODE=y
CONFIG_BCM4361=y
CONFIG_BCMDHD_FW_PATH=y
CONFIG_BCMDHD_NVRAM_PATH=y
CONFIG_WIRELESS=y
CONFIG_WIRELESS_EXT_SYSFS=y
CONFIG_WEXT_CORE=y
CONFIG_WEXT_PROC=y
CONFIG_CFG80211=y
CONFIG_CFG80211_DEFAULT_PS=y
CONFIG_CFG80211_ALLOW_RECONNECT=y
CONFIG_WLAN=y
CONFIG_WIFI_CONTROL_FUNC=y
CONFIG_BROADCOM_WIFI_RESERVED_MEM=y
CONFIG_CFG80211_REG_NOT_UPDATED=y
CONFIG_WIFI_MULTICAST_LOG=y
CONFIG_BCMDHD_PCIE=y
CONFIG_BCMDHD_PREALLOC_MEMDUMP=y
CONFIG_BCMDHD_OOB_HOST_WAKE=y
CONFIG_TUN=y
CONFIG_PPP=y
CONFIG_PPP_BSDCOMP=y
CONFIG_PPP_DEFLATE=y
CONFIG_PPP_MPPE=y
CONFIG_PPPOLAC=y
CONFIG_PPPOPNS=y
CONFIG_INPUT_EVDEV=y
CONFIG_INPUT_KEYRESET=y
CONFIG_KEYBOARD_GPIO=y
# CONFIG_INPUT_MOUSE is not set
CONFIG_INPUT_JOYSTICK=y
CONFIG_INPUT_TABLET=y
CONFIG_INPUT_TOUCHSCREEN=y
CONFIG_TOUCHSCREEN_SEC_TS=y
CONFIG_INPUT_TOUCHSCREEN_TCLM=y
CONFIG_INPUT_MISC=y
CONFIG_INPUT_KEYCHORD=y
CONFIG_INPUT_UINPUT=y
CONFIG_INPUT_GPIO=y
CONFIG_TOUCHSCREEN_DUMP_MODE=y
CONFIG_SEC_DEBUG_TSP_LOG=y
# CONFIG_SERIO_SERPORT is not set
# CONFIG_VT is not set
# CONFIG_LEGACY_PTYS is not set
# CONFIG_DEVMEM is not set
# CONFIG_DEVKMEM is not set
CONFIG_SERIAL_SAMSUNG=y
CONFIG_SERIAL_SAMSUNG_CONSOLE=y
# CONFIG_HW_RANDOM_EXYNOS is not set
CONFIG_EXYRNG_FIPS_COMPLIANCE=y
CONFIG_EXYRNG_FAIL_POLICY_RESET=y
CONFIG_EXYRNG_USE_CRYPTOMANAGER=y
CONFIG_I2C_CHARDEV=y
CONFIG_SPI=y
CONFIG_SPI_S3C64XX=y
CONFIG_GPIOLIB=y
CONFIG_GPIO_PCAL6524=y
CONFIG_SENSORS_SEC_THERMISTOR=y
CONFIG_THERMAL=y
CONFIG_THERMAL_WRITABLE_TRIPS=y
CONFIG_THERMAL_GOV_POWER_ALLOCATOR=y
CONFIG_CPU_THERMAL=y
CONFIG_GPU_THERMAL=y
CONFIG_ISP_THERMAL=y
CONFIG_THERMAL_EMULATION=y
CONFIG_EXYNOS_THERMAL=y
CONFIG_EXYNOS_ACPM_THERMAL=y
CONFIG_WATCHDOG=y
CONFIG_S3C2410_WATCHDOG=y
CONFIG_MFD_SEC_CORE=y
CONFIG_MFD_S2MPS18=y
CONFIG_MFD_S2MPB02=y
CONFIG_REGULATOR_FIXED_VOLTAGE=y
CONFIG_REGULATOR_S2MPS18=y
CONFIG_REGULATOR_S2MPB02=y
CONFIG_REGULATOR_S2MPB03=y
CONFIG_REGULATOR_S2DOS05=y
CONFIG_MEDIA_SUPPORT=y
CONFIG_MEDIA_CAMERA_SUPPORT=y
CONFIG_V4L_PLATFORM_DRIVERS=y
CONFIG_VIDEO_EXYNOS_SCALER=y
CONFIG_VIDEO_EXYNOS_REPEATER=y
CONFIG_VIDEO_EXYNOS_TSMUX=y
CONFIG_VIDEO_EXYNOS_MFC=y
CONFIG_VIDEO_EXYNOS_SMFC=y
CONFIG_VIDEO_EXYNOS_FIMC_IS2=y
CONFIG_USE_CSI_DMAOUT_FEATURE=y
CONFIG_CAMERA_CIS_3H1_OBJ=y
CONFIG_CAMERA_CIS_2L3_OBJ=y
CONFIG_CAMERA_CIS_5F1_OBJ=y
CONFIG_SENSOR_RETENTION_USE=y
CONFIG_CAMERA_ACT_AK737X_OBJ=y
CONFIG_CAMERA_EEPROM_SUPPORT_FRONT=y
CONFIG_VENDER_MCD=y
CONFIG_OIS_USE=y
CONFIG_AF_HOST_CONTROL=y
CONFIG_CAMERA_APERTURE_AK7372_OBJ=y
CONFIG_CAMERA_FLASH_S2MPB02_OBJ=y
CONFIG_LEDS_S2MPB02=y
# CONFIG_LEDS_IRIS_IRLED_CERTIFICATE_SUPPORT is not set
CONFIG_SECURE_CAMERA_USE=y
CONFIG_LEDS_IRIS_IRLED_SUPPORT=y
CONFIG_USE_DIRECT_IS_CONTROL=y
CONFIG_USE_SENSOR_GROUP=y
CONFIG_MALI_MIDGARD=y
CONFIG_MALI_MIDGARD_ENABLE_TRACE=y
CONFIG_MALI_EXPERT=y
CONFIG_MALI_PLATFORM_THIRDPARTY=y
CONFIG_MALI_PLATFORM_THIRDPARTY_NAME="exynos"
CONFIG_EXYNOS_SOC_NAME="9810"
CONFIG_MALI_EXYNOS_SECURE_RENDERING=y
CONFIG_MALI_THEX=y
CONFIG_EXYNOS_HDR_TUNABLE_TONEMAPPING=y
CONFIG_EXYNOS_GRAPHICS_G2D=y
CONFIG_FB=y
CONFIG_FB_MODE_HELPERS=y
CONFIG_FB_SIMPLE=y
CONFIG_FB_WINDOW_UPDATE=y
CONFIG_DECON_HIBER=y
CONFIG_EXYNOS_AFBC=y
CONFIG_DECON_BTS_LEGACY=y
CONFIG_DPU_2_0_FENCE=y
CONFIG_DPU_2_0_RELEASE_FENCES=y
CONFIG_EXYNOS_DECON_LCD=y
CONFIG_BACKLIGHT_LCD_SUPPORT=y
# CONFIG_BACKLIGHT_GENERIC is not set
CONFIG_SOUND=y
CONFIG_SND=y
CONFIG_SND_DYNAMIC_MINORS=y
CONFIG_SND_USB_AUDIO=y
# CONFIG_SND_EXYNOS_USB_AUDIO is not set
CONFIG_SND_SOC=y
CONFIG_SND_SOC_SAMSUNG=y
CONFIG_SND_SOC_SAMSUNG_EXYNOS9810=y
CONFIG_SND_SOC_SAMSUNG_EXYNOS9810_MOON=y
CONFIG_SND_SOC_SAMSUNG_EXYNOS9810_MAX98512=y
CONFIG_SND_SOC_SAMSUNG_MAILBOX=y
CONFIG_SND_SOC_SAMSUNG_VTS=y
CONFIG_HIDRAW=y
CONFIG_HID_OVR=y
CONFIG_HID_TVR=y
CONFIG_UHID=y
CONFIG_HID_A4TECH=y
CONFIG_HID_ACRUX=y
CONFIG_HID_ACRUX_FF=y
CONFIG_HID_APPLE=y
CONFIG_HID_BELKIN=y
CONFIG_HID_CHERRY=y
CONFIG_HID_CHICONY=y
CONFIG_HID_PRODIKEYS=y
CONFIG_HID_CYPRESS=y
CONFIG_HID_DRAGONRISE=y
CONFIG_DRAGONRISE_FF=y
CONFIG_HID_EMS_FF=y
CONFIG_HID_ELECOM=y
CONFIG_HID_EZKEY=y
CONFIG_HID_KEYTOUCH=y
CONFIG_HID_KYE=y
CONFIG_HID_WALTOP=y
CONFIG_HID_GYRATION=y
CONFIG_HID_TWINHAN=y
CONFIG_HID_KENSINGTON=y
CONFIG_HID_LCPOWER=y
CONFIG_HID_LOGITECH=y
CONFIG_HID_LOGITECH_DJ=y
CONFIG_LOGITECH_FF=y
CONFIG_LOGIRUMBLEPAD2_FF=y
CONFIG_LOGIG940_FF=y
CONFIG_HID_MAGICMOUSE=y
CONFIG_HID_MICROSOFT=y
CONFIG_HID_MONTEREY=y
CONFIG_HID_MULTITOUCH=y
CONFIG_HID_MADCATZ=y
CONFIG_HID_ORTEK=y
CONFIG_HID_PANTHERLORD=y
CONFIG_PANTHERLORD_FF=y
CONFIG_HID_PETALYNX=y
CONFIG_HID_PICOLCD=y
CONFIG_HID_PRIMAX=y
CONFIG_HID_SAITEK=y
CONFIG_HID_SAMSUNG=y
CONFIG_HID_SYNAPTICS_BT=y
CONFIG_HID_SPEEDLINK=y
CONFIG_HID_SUNPLUS=y
CONFIG_HID_GREENASIA=y
CONFIG_GREENASIA_FF=y
CONFIG_HID_SMARTJOYPLUS=y
CONFIG_SMARTJOYPLUS_FF=y
CONFIG_HID_TIVO=y
CONFIG_HID_TOPSEED=y
CONFIG_HID_THRUSTMASTER=y
CONFIG_HID_ZEROPLUS=y
CONFIG_HID_ZYDACRON=y
CONFIG_USB_HMT_SAMSUNG_INPUT=y
CONFIG_DRAGONRISE_FF=y
CONFIG_GREENASIA_FF=y
CONFIG_HID_GREENASIA=y
CONFIG_HID_HOLTEK=y
CONFIG_HID_NTRIG=y
CONFIG_HID_ROCCAT=y
CONFIG_HID_SMARTJOYPLUS=y
CONFIG_HID_SONY=y
CONFIG_SONY_FF=y
CONFIG_HID_SYNAPTICS_BT=y
CONFIG_HID_THRUSTMASTER=y
CONFIG_HID_TIVO=y
CONFIG_HID_TOPSEED=y
CONFIG_HID_UCLOGIC=y
CONFIG_HID_WACOM=y
CONFIG_HID_WIIMOTE=y
CONFIG_HID_ZEROPLUS=y
CONFIG_HID_ZYDACRON=y
CONFIG_MMC=y
CONFIG_MMC_BLOCK_DEFERRED_RESUME=y
CONFIG_MMC_DW=y
CONFIG_MMC_DW_IDMAC=y
CONFIG_MMC_DW_64BIT_DESC=y
CONFIG_MMC_DW_EXYNOS=y
CONFIG_MMC_DW_DEBUG=y
CONFIG_MMC_DW_FORCE_32BIT_SFR_RW=y
CONFIG_RTC_CLASS=y
CONFIG_RTC_DRV_S2MPS18=y
CONFIG_DMADEVICES=y
CONFIG_SYNC_FILE=y
CONFIG_SW_SYNC=y
CONFIG_STAGING=y
CONFIG_ASHMEM=y
CONFIG_ANDROID_LOW_MEMORY_KILLER=y
CONFIG_ANDROID_INTF_ALARM_DEV=y
CONFIG_ION=y
CONFIG_ION_TEST=y
CONFIG_ION_EXYNOS=y
CONFIG_ANDROID_SWITCH=y
CONFIG_EXYNOS_IOMMU=y
CONFIG_EXYNOS_CHIPID=y
CONFIG_EXYNOS_PMU=y
CONFIG_ECT=y
CONFIG_ECT_DUMP=y
CONFIG_EXYNOS_PD=y
CONFIG_CAL_IF=y
CONFIG_SAMSUNG_VST_CAL=y
CONFIG_EXYNOS_REBOOT=y
CONFIG_EXYNOS_PM_DVS=y
CONFIG_FLEXPMU=y
CONFIG_CP_PMUCAL=y
CONFIG_CMUCAL_DEBUG=y
CONFIG_CMUCAL_QCH_IGNORE_SUPPORT=y
CONFIG_EXYNOS_ACPM=y
CONFIG_EXYNOS_ACPM_S2D=y
CONFIG_USI_V2=y
CONFIG_EXYNOS_HOTPLUG_GOVERNOR=y
CONFIG_EXYNOS_DVFS_MANAGER=y
CONFIG_EXYNOS_MCINFO=y
CONFIG_EXYNOS_KERNEL_PROTECTION=y
CONFIG_PM_DEVFREQ=y
CONFIG_ARM_EXYNOS_DEVFREQ=y
CONFIG_ARM_EXYNOS_DEVFREQ_DEBUG=y
CONFIG_EXTCON=y
CONFIG_IIO=y
CONFIG_EXYNOS_ADC=y
CONFIG_PWM=y
CONFIG_PWM_SAMSUNG=y
CONFIG_BATTERY_SAMSUNG=y
CONFIG_BATTERY_SWELLING=y
CONFIG_CALC_TIME_TO_FULL=y
CONFIG_BATTERY_AGE_FORECAST=y
CONFIG_AFC_CHARGER_MODE=y
CONFIG_BATTERY_NOTIFIER=y
CONFIG_BATTERY_SAMSUNG_V2=y
# CONFIG_PHY_EXYNOS_MIPI_VIDEO is not set
CONFIG_PHY_EXYNOS9810_MIPI=y
CONFIG_PHY_EXYNOS_DISPLAYPORT=y
CONFIG_HDCP2_FUNC_TEST_MODE=y
# CONFIG_PHY_EXYNOS_DP_VIDEO is not set
CONFIG_SEC_DISPLAYPORT_LOGGER=y
CONFIG_SEC_DISPLAYPORT_BIGDATA=y
CONFIG_ANDROID=y
CONFIG_ANDROID_BINDER_IPC=y
CONFIG_VISION_SUPPORT=y
CONFIG_EXYNOS_IVA=y
CONFIG_EXYNOS_SCORE=y
CONFIG_EXYNOS_SCORE_V2=y
CONFIG_EXYNOS_SNAPSHOT_S2D=y
CONFIG_EXYNOS_SNAPSHOT_CACHEDUMP=y
CONFIG_EXYNOS_CORESIGHT=y
CONFIG_CCIC_NOTIFIER=y
CONFIG_CCIC_S2MM005=y
CONFIG_CCIC_ALTERNATE_MODE=y
CONFIG_SECURE_OS_CONTROL=y
CONFIG_SECURE_OS_BOOSTER_API=y
CONFIG_EXT2_FS=y
CONFIG_EXT3_FS=y
CONFIG_EXT4_FS_SECURITY=y
CONFIG_EXT4_ENCRYPTION=y
CONFIG_FS_PRIVATE_ENCRYPTION=y
CONFIG_QUOTA=y
CONFIG_QUOTA_NETLINK_INTERFACE=y
CONFIG_QFMT_V2=y
CONFIG_FUSE_FS=y
CONFIG_MSDOS_FS=y
CONFIG_VFAT_FS=y
CONFIG_TMPFS=y
CONFIG_TMPFS_POSIX_ACL=y
CONFIG_ECRYPT_FS=y
CONFIG_ECRYPT_FS_PRIVATE=y
CONFIG_CRAMFS=y
CONFIG_PSTORE=y
CONFIG_PSTORE_RAM=y
CONFIG_PSTORE_PMSG=y
CONFIG_PSTORE_CONSOLE=y
CONFIG_NLS_CODEPAGE_437=y
CONFIG_NLS_ISO8859_1=y
CONFIG_PRINTK_TIME=y
CONFIG_PRINTK_PROCESS=y
CONFIG_DEBUG_INFO=y
CONFIG_SLUB_DEBUG=y
CONFIG_FRAME_WARN=4096
CONFIG_LOCKUP_DETECTOR=y
CONFIG_MAGIC_SYSRQ=y
CONFIG_BOOTPARAM_HARDLOCKUP_PANIC=y
CONFIG_BOOTPARAM_SOFTLOCKUP_PANIC=y
CONFIG_PANIC_TIMEOUT=5
CONFIG_SCHEDSTATS=y
CONFIG_TIMER_STATS=y
# CONFIG_DEBUG_PREEMPT is not set
# CONFIG_DEBUG_RT_MUTEXES is not set
# CONFIG_DEBUG_LOCK_ALLOC is not set
CONFIG_DEBUG_ATOMIC_SLEEP=y
CONFIG_DEBUG_ATOMIC_SLEEP_PANIC=y
CONFIG_DEBUG_LIST=y
CONFIG_ENABLE_DEFAULT_TRACERS=y
CONFIG_ATOMIC64_SELFTEST=y
CONFIG_DEBUG_EXCEPTION_STACK=y
# Fingerprint
CONFIG_SENSORS_FINGERPRINT=y
CONFIG_SENSORS_ET5XX=y
CONFIG_SENSORS_FP_SPI_NUMBER=1
CONFIG_SENSORS_FP_USI_NUMBER=0
# NFC
CONFIG_SAMSUNG_NFC=y
CONFIG_SEC_NFC=y
CONFIG_ESE_P3_LSI=y
CONFIG_ESE_SECURE=y
CONFIG_ESE_SECURE_SPI_PORT=7
CONFIG_ESE_SECURE_USI_MODE=12
CONFIG_SEC_NFC_LOGGER=y
# BT
CONFIG_BT=y
CONFIG_RFKILL=y
CONFIG_BT_BCM43XX=y
CONFIG_SECURITY_PERF_EVENTS_RESTRICT=y
CONFIG_SECURITY=y
CONFIG_SECURITY_NETWORK=y
CONFIG_HARDENED_USERCOPY=y
CONFIG_SECURITY_SELINUX=y
CONFIG_EXYNOS_SMU=y
CONFIG_EXYNOS_FMP=y
CONFIG_SCSI_UFS_EXYNOS_FMP=y
CONFIG_SCSI_UFS_EXYNOS_SMU=y
CONFIG_EXYNOS_FMP_FILE_DISK_ENCRYPTION=y
CONFIG_EXYNOS_FMP_FIPS=y
CONFIG_ARM64_CRYPTO=y
CONFIG_CRYPTO_SHA1_ARM64_CE=y
CONFIG_CRYPTO_SHA2_ARM64_CE=y
CONFIG_CRYPTO_AES_ARM64_CE_BLK=y
CONFIG_CRYPTO_CRC32_ARM64=y
# SEC NAD
CONFIG_SEC_NAD=y
CONFIG_SEC_SUPPORT_SECOND_NAD=y
CONFIG_SEC_NAD_BALANCER=y
CONFIG_SEC_SUPPORT_VST=y
CONFIG_SEC_NAD_API=y
# SEC Connector detector driver
CONFIG_SEC_CONNECTOR_DETECTOR=y
# SensorHub
#CONFIG_SENSORS_SSP_STM=y
#CONFIG_SENSORS_SSP_ATMEL=y
CONFIG_GPS_BCM4773=y
CONFIG_SENSORS_SSP_BBD=y
CONFIG_SENSORS_SSP=y
CONFIG_SENSORS_SYSFS=y
CONFIG_SENSORS_SSP_SENSORHUB=y
CONFIG_SENSORS_SSP_FACTORY=y
CONFIG_SENSORS_SSP_LSM6DSL=y
CONFIG_SENSORS_SSP_LPS22H=y
CONFIG_SENSORS_SSP_MAGNETIC_COMMON=y
CONFIG_SENSORS_SSP_TMD4906=y
CONFIG_SENSORS_SSP_IRDATA_FOR_CAMERA=y
CONFIG_SENSORS_SSP_INTERRUPT_GYRO_SENSOR=y
#CONFIG_SENSORS_SSP_PROX_FACTORYCAL=y
CONFIG_SENSORS_SSP_PROX_AUTOCAL_AMS=y
CONFIG_SENSORS_SSP_MOBEAM=y
CONFIG_SENSORS_MULTIPLE_GLASS_TYPE=y
CONFIG_SENSORS_SSP_HIFI_BATCHING=y
CONFIG_SENSORS_SSP_LIGHT_REPORT_LUX=y
CONFIG_SENSORS_SSP_LIGHT_COLORID=y
CONFIG_SSP_MOTOR_CALLBACK=y
CONFIG_SENSORS_SSP_THERMISTOR=y
CONFIG_SSP_SUPPORT_MAGNETIC_OVERFLOW=y
CONFIG_IIO=y
CONFIG_IIO_BUFFER=y
CONFIG_IIO_KFIFO_BUF=y
CONFIG_IIO_TRIGGER=y
CONFIG_GPS_BCM47531=y
CONFIG_GPS_BCMxxxxx=y
CONFIG_GPIO_SYSFS=y

# [ SEC_SELINUX_PORTING_EXYNOS
CONFIG_EXT2_FS_XATTR=y
CONFIG_EXT2_FS_SECURITY=y
CONFIG_EXT4_FS_XATTR=y
CONFIG_EXT4_FS_SECURITY=y
CONFIG_JOURNAL_DATA_TAG=y
CONFIG_AUDIT=y
CONFIG_SECURITY=y
CONFIG_LSM_MMAP_MIN_ADDR=4096
CONFIG_SECURITY_NETWORK=y
CONFIG_SECURITY_SELINUX=y
CONFIG_DEFAULT_SECURITY_SELINUX=y
CONFIG_NETWORK_SECMARK=y
CONFIG_NETFILTER_XT_TARGET_CONNSECMARK=y
CONFIG_NETFILTER_ADVANCED=y
CONFIG_IP_NF_SECURITY=y
CONFIG_AUDITSYSCALL=y
CONFIG_SEC_AVC_LOG=y
CONFIG_SDCARD_FS_XATTR=y
CONFIG_ECRYPT_FS_VIRTUAL_FAT_XATTR=y
CONFIG_FAT_VIRTUAL_XATTR=y
CONFIG_EXFAT_VIRTUAL_XATTR=y
# ] SEC_SELINUX_PORTING_EXYNOS

# ODE and Sd Card Encryption
CONFIG_KEYS=y
# CONFIG_KEYS_DEBUG_PROC_KEYS is not set
CONFIG_CRYPTO=y
CONFIG_CRYPTO_AES=y
CONFIG_CRYPTO_CBC=y
CONFIG_CRYPTO_TWOFISH=y
CONFIG_CRYPTO_SHA1=y
CONFIG_CRYPTO_SHA256=y
# CONFIG_FS_CRYPTO_SEC_EXTENSION is not set
CONFIG_ECRYPT_FS=y
CONFIG_WTL_ENCRYPTION_FILTER=y
CONFIG_KEYS_DEBUG_PROC_KEYS=y
CONFIG_ECRYPTFS_FEK_INTEGRITY=y

# Google Requirement for O
CONFIG_MODULES=y
CONFIG_MODULE_UNLOAD=y
CONFIG_MODVERSIONS=y
# CONFIG_MODULE_SRCVERSION_ALL is not set

# Build Error due to module build
CONFIG_LCD_CLASS_DEVICE=y
CONFIG_BACKLIGHT_CLASS_DEVICE=y

# FIPS for Kernel Crypto API
CONFIG_CRYPTO_FIPS=y
CONFIG_CRYPTO_TEST=y
CONFIG_CRYPTO_AES=y
CONFIG_CRYPTO_SHA1=y
CONFIG_CRYPTO_SHA256=y
CONFIG_CRYPTO_SHA512=y
CONFIG_CRYPTO_DRBG_MENU=y
CONFIG_CRYPTO_DRBG=y
CONFIG_CRYPTO_DRBG_HMAC=y
# CONFIG_CRYPTO_DRBG_CTR is not set
# CONFIG_CRYPTO_DRBG_HASH is not set
# CONFIG_CRYPTO_ANSI_CPRNG is not set
CONFIG_CRYPTO_GCM=y
CONFIG_CRYPTO_AEAD2=y
CONFIG_CRYPTO_POST_LATE_INIT_SYNC=y
CONFIG_CRYPTO_ZSTD=y
CONFIG_LOG_BUF_SHIFT=19

# disable module
CONFIG_HW_RANDOM=y
CONFIG_ARGOS=y
CONFIG_SEC_BOOTSTAT=y
CONFIG_SEC_PARAM=y
CONFIG_CM_OFFSET=7340596

# vibrator
CONFIG_SEC_HAPTIC=y

# USB
CONFIG_USB=y
CONFIG_USB_XHCI_HCD=y
CONFIG_USB_PRINTER=y
CONFIG_USB_STORAGE=y
CONFIG_USB_HOST_NOTIFY=y
CONFIG_USB_NOTIFY_LAYER=y
CONFIG_USB_NOTIFIER=y
CONFIG_USB_STORAGE_DETECT=y
CONFIG_USB_DEBUG_DETAILED_LOG=y
CONFIG_USB_TYPEC_MANAGER_NOTIFIER=y
CONFIG_USB_DWC3=y
CONFIG_DUAL_ROLE_USB_INTF=y
CONFIG_USB_GADGET=y
CONFIG_USB_CONFIGFS=y
CONFIG_USB_CONFIGFS_ACM=y
CONFIG_USB_CONFIGFS_RNDIS=y
CONFIG_USB_CONFIGFS_F_FS=y
CONFIG_USB_CONFIGFS_F_DM=y
CONFIG_USB_CONFIGFS_F_MTP=y
CONFIG_USB_CONFIGFS_F_PTP=y
CONFIG_USB_CONFIGFS_F_ACC=y
CONFIG_USB_CONFIGFS_F_MIDI=y
CONFIG_USB_CONFIGFS_F_AUDIO_SRC=y
CONFIG_USB_CONFIGFS_F_RNDIS=y
CONFIG_USB_CONFIGFS_NCM=y
CONFIG_USB_CONFIGFS_UEVENT=y
CONFIG_USB_G_ANDROID=y
CONFIG_USB_ANDROID_SAMSUNG_COMPOSITE=y
CONFIG_USB_DUN_SUPPORT=y
CONFIG_USB_RNDIS_MULTIPACKET=y
CONFIG_USB_NCM_SUPPORT_MTU_CHANGE=y
CONFIG_USB_NOTIFY_PROC_LOG=y
CONFIG_USB_USBNET=y
CONFIG_USB_NET_SMSC75XX=y
CONFIG_USB_NET_SMSC95XX=y
CONFIG_USB_RTL8152=y
CONFIG_USB_RTL8150=y
CONFIG_USB_NET_CDC_EEM=y
CONFIG_USB_NET_CDC_MBIM=y
CONFIG_USB_ANNOUNCE_NEW_DEVICES=y
CONFIG_USB_EXTERNAL_NOTIFY=y
CONFIG_USB_HW_PARAM=y
CONFIG_USB_HOST_SAMSUNG_FEATURE=y
CONFIG_USB_SERIAL=y
CONFIG_USB_SERIAL_FTDI_SIO=y
CONFIG_USB_SERIAL_PL2303=y
CONFIG_USB_HIDDEV=y
CONFIG_SND_USB_MIDI=y
CONFIG_USB_ACM=y
CONFIG_USB_NET_AX8817X=y
CONFIG_USB_NET_AX88179_178A=y
CONFIG_USB_NET_CDCETHER=y
CONFIG_USB_NET_CDC_NCM=y
CONFIG_USB_NET_NET1080=y
CONFIG_USB_NET_CDC_SUBSET=y
CONFIG_USB_BELKIN=y
CONFIG_USB_ARMLINUX=y
CONFIG_USB_NET_ZAURUS=y
CONFIG_SND_USB=y
CONFIG_GREENASIA_FF=y
CONFIG_JOYSTICK_XPAD_FF=y
CONFIG_JOYSTICK_XPAD_LEDS=y
CONFIG_JOYSTICK_XPAD=y
CONFIG_TABLET_USB_ACECAD=y
CONFIG_TABLET_USB_AIPTEK=y
CONFIG_TABLET_USB_GTCO=y
CONFIG_TABLET_USB_HANWANG=y
CONFIG_TABLET_USB_KBTAB=y
CONFIG_TABLET_USB_WACOM=y
CONFIG_SWITCH=y
CONFIG_USB_ANDROID_SAMSUNG_DISABLE_U1_U2=y

#EPDG
CONFIG_NET_CORE=y
CONFIG_NET_SCH_PRIO=y
#CONFIG_NET_SCHED=y   #depends on CONFIG_NET  which is enabled by default.. coz not seeing in the config file
CONFIG_NET_CLS_BASIC=y # required if basic is being used as a filter. depends on CONFIG_NET_CLS so enabling it by default
CONFIG_NET_CLS=y
#CONFIG_NET_CLS_ACT=y # for enabling the action target.
#CONFIG_NET_ACT_MIRRED=y  # for enabling the mirred target for redirecting the packet between the devices.
#CONFIG_NET_EMATCH=y   #basic uses extended matches so this has to be present
#CONFIG_NET_SCH_INGRESS=y # classifier for ingress packet
#EPDG

# TIMA
CONFIG_TIMA=y
CONFIG_TIMA_LKMAUTH=y
CONFIG_TIMA_LKM_BLOCK=y
# CONFIG_ARM_PATCH_PHYS_VIRT is not set
# CONFIG_FUNCTION_TRACER is not set
# CONFIG_FTRACE is not set

# uH
CONFIG_UH=y
CONFIG_UH_DEBUG=y
CONFIG_UH_INFORM=y
CONFIG_UH_RKP=y
CONFIG_UH_RKP_6G=y
# CONFIG_RKP_KDP is not set

CONFIG_DEFERRED_INITCALLS=y
CONFIG_SEC_DUMP_SUMMARY=y
CONFIG_SEC_DEBUG_AUTO_SUMMARY=y
CONFIG_SEC_DEBUG_PPMPU=y
CONFIG_SEC_DEBUG_BRANCH_VERIFIER=y
CONFIG_SEC_DEBUG_INDIRECT_BRANCH_VERIFIER=y

# BLOCK
CONFIG_LARGE_DIRTY_BUFFER=y
CONFIG_MAX_DIRTY_THRESH_PAGES=25600

# ASTC
CONFIG_VIDEO_EXYNOS_ASTC=y

#BarTender
CONFIG_FAIR_GROUP_SCHED=y
CONFIG_CFS_BANDWIDTH=y

# SDP
CONFIG_SDP=y

#DLP
CONFIG_DLP=y

# Rooting Prevention
CONFIG_SEC_RESTRICT_ROOTING=y
CONFIG_SEC_RESTRICT_SETUID=y
CONFIG_SEC_RESTRICT_FORK=y
CONFIG_SEC_RESTRICT_ROOTING_LOG=y

#SSRM
CONFIG_SEC_HEAVY_TASK_CPU=y

# HQM Feature
CONFIG_SEC_HQM_DEVICE=y

# STI
CONFIG_SEC_STI=y
# ABC
CONFIG_SEC_ABC=y
CONFIG_SEC_ABC_HUB=y
CONFIG_SEC_ABC_HUB_COND=y
CONFIG_SEC_ABC_HUB_BOOTC=y

CONFIG_S3C2410_SHUTDOWN_REBOOT=y
CONFIG_DEBUG_NOTIFIERS_PRINT_ELAPSED_TIME=y

#FreeCess
CONFIG_SAMSUNG_FREECESS=y
```
