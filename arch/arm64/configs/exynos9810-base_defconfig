## arch/arm64/configs/exynos9830-base_defconfig
```kconfig
CONFIG_AUDIT=y
CONFIG_NO_HZ=y
CONFIG_HIGH_RES_TIMERS=y
CONFIG_PREEMPT=y
CONFIG_TASKSTATS=y
CONFIG_TASK_DELAY_ACCT=y
CONFIG_TASK_XACCT=y
CONFIG_TASK_IO_ACCOUNTING=y
CONFIG_PSI=y
CONFIG_IKCONFIG=y
CONFIG_IKCONFIG_PROC=y
CONFIG_LOG_BUF_SHIFT=21
CONFIG_CGROUPS=y
CONFIG_MEMCG=y
CONFIG_MEMCG_SWAP=y
CONFIG_CGROUP_SCHED=y
CONFIG_RT_GROUP_SCHED=y
CONFIG_CGROUP_FREEZER=y
CONFIG_CPUSETS=y
CONFIG_CGROUP_CPUACCT=y
CONFIG_CGROUP_BPF=y
# CONFIG_CGROUP_DEBUG is not set
CONFIG_NAMESPACES=y
CONFIG_SCHED_EMS=y
CONFIG_SCHED_USE_FLUID_RT=y
CONFIG_SCHED_TUNE=y
CONFIG_BLK_DEV_INITRD=y
CONFIG_CC_OPTIMIZE_FOR_SIZE=y
# CONFIG_FHANDLE is not set
CONFIG_BPF_SYSCALL=y
CONFIG_EMBEDDED=y
# CONFIG_COMPAT_BRK is not set
CONFIG_PROFILING=y
CONFIG_SOC_EXYNOS9830=y
CONFIG_ARCH_EXYNOS9=y
CONFIG_PCI=y
CONFIG_PCIE_DW_PLAT_HOST=y
CONFIG_PCI_EXYNOS=y
# CONFIG_CAVIUM_ERRATUM_22375 is not set
# CONFIG_CAVIUM_ERRATUM_23154 is not set
# CONFIG_CAVIUM_ERRATUM_27456 is not set
# CONFIG_CAVIUM_ERRATUM_30115 is not set
# CONFIG_QCOM_FALKOR_ERRATUM_1003 is not set
# CONFIG_QCOM_FALKOR_ERRATUM_1009 is not set
# CONFIG_QCOM_QDF2400_ERRATUM_0065 is not set
CONFIG_SCHED_MC=y
CONFIG_NR_CPUS=8
CONFIG_SECCOMP=y
CONFIG_ARMV8_DEPRECATED=y
CONFIG_SWP_EMULATION=y
CONFIG_CP15_BARRIER_EMULATION=y
CONFIG_SETEND_EMULATION=y
# CONFIG_ARM64_VHE is not set
CONFIG_RANDOMIZE_BASE=y
CONFIG_CMDLINE=""
CONFIG_CMDLINE_EXTEND=y
# CONFIG_EFI is not set
CONFIG_COMPAT=y
CONFIG_PM_AUTOSLEEP=y
CONFIG_PM_WAKELOCKS=y
CONFIG_PM_WAKELOCKS_LIMIT=0
# CONFIG_PM_WAKELOCKS_GC is not set
# CONFIG_PM_DEBUG is not set
CONFIG_ENERGY_MODEL=y
CONFIG_CPU_IDLE=y
CONFIG_ARM64_EXYNOS_CPUIDLE=y
CONFIG_ARM64_EXYNOS_MOCE=y
CONFIG_ARM_EXYNOS_UFC=y
CONFIG_CPU_FREQ=y
CONFIG_CPU_FREQ_STAT=y
CONFIG_CPU_FREQ_TIMES=y
CONFIG_CPU_FREQ_DEFAULT_GOV_ENERGYSTEP=y
CONFIG_CPU_FREQ_GOV_SCHEDUTIL=y
CONFIG_ARM_EXYNOS_ACME=y
CONFIG_EXYNOS_PSTATE_HAFM=y
CONFIG_KPROBES=y
CONFIG_CRYPTO_NULL=y
CONFIG_LTO_CLANG=y
CONFIG_CFI_CLANG=y
CONFIG_MODULES=y
CONFIG_MODULE_UNLOAD=y
CONFIG_MODVERSIONS=y
# CONFIG_BLK_DEV_BSG is not set
CONFIG_PARTITION_ADVANCED=y
# CONFIG_IOSCHED_DEADLINE is not set
# CONFIG_CORE_DUMP_DEFAULT_ELF_HEADERS is not set
CONFIG_MEMORY_HOTPLUG=y
CONFIG_MEMORY_HOTREMOVE=y
# CONFIG_CMA_DEBUGFS is not set
CONFIG_HPA=y
CONFIG_PAGE_STEAL=y
CONFIG_NET=y
CONFIG_PACKET=y
CONFIG_UNIX=y
CONFIG_XFRM_USER=y
CONFIG_XFRM_INTERFACE=y
CONFIG_XFRM_STATISTICS=y
CONFIG_NET_KEY=y
CONFIG_INET=y
CONFIG_IP_MULTICAST=y
CONFIG_IP_ADVANCED_ROUTER=y
CONFIG_IP_MULTIPLE_TABLES=y
CONFIG_IP_PNP=y
CONFIG_IP_PNP_DHCP=y
CONFIG_IP_PNP_BOOTP=y
CONFIG_IP_PNP_RARP=y
CONFIG_NET_IPGRE_DEMUX=y
CONFIG_NET_IPVTI=y
CONFIG_INET_ESP=y
# CONFIG_INET_XFRM_MODE_BEET is not set
CONFIG_INET_UDP_DIAG=y
CONFIG_INET_DIAG=y
CONFIG_INET_DIAG_DESTROY=y
CONFIG_IPV6_ROUTER_PREF=y
CONFIG_IPV6_ROUTE_INFO=y
CONFIG_IPV6_OPTIMISTIC_DAD=y
CONFIG_INET6_AH=y
CONFIG_INET6_ESP=y
CONFIG_INET_XFRM_MODE_TUNNEL=y
CONFIG_INET_XFRM_MODE_TRANSPORT=y
CONFIG_INET6_XFRM_MODE_BEET=y
CONFIG_INET6_IPCOMP=y
CONFIG_IPV6_MIP6=y
CONFIG_IPV6_VTI=y
CONFIG_IPV6_MULTIPLE_TABLES=y
CONFIG_NETFILTER=y
CONFIG_NF_CONNTRACK=y
CONFIG_NF_CONNTRACK_SECMARK=y
CONFIG_NF_CONNTRACK_EVENTS=y
CONFIG_NF_CONNTRACK_AMANDA=y
CONFIG_NF_CONNTRACK_FTP=y
CONFIG_NF_CONNTRACK_H323=y
CONFIG_NF_CONNTRACK_IPV6=y
CONFIG_NF_CONNTRACK_IRC=y
CONFIG_NF_CONNTRACK_NETBIOS_NS=y
CONFIG_NF_CONNTRACK_PPTP=y
CONFIG_NF_CONNTRACK_SANE=y
CONFIG_NF_CONNTRACK_TFTP=y
CONFIG_NF_CT_NETLINK=y
CONFIG_NETFILTER_XT_TARGET_CLASSIFY=y
CONFIG_NETFILTER_XT_TARGET_CONNMARK=y
CONFIG_NETFILTER_XT_TARGET_CONNSECMARK=y
CONFIG_NETFILTER_XT_TARGET_CT=y
CONFIG_NETFILTER_XT_TARGET_IDLETIMER=y
CONFIG_NETFILTER_XT_TARGET_MARK=y
CONFIG_NETFILTER_XT_TARGET_NFLOG=y
CONFIG_NETFILTER_XT_TARGET_NFQUEUE=y
CONFIG_NETFILTER_XT_TARGET_TPROXY=y
CONFIG_NETFILTER_XT_TARGET_TRACE=y
CONFIG_NETFILTER_XT_TARGET_SECMARK=y
CONFIG_NETFILTER_XT_TARGET_TCPMSS=y
CONFIG_NETFILTER_XT_MATCH_BPF=y
CONFIG_NETFILTER_XT_MATCH_COMMENT=y
CONFIG_NETFILTER_XT_MATCH_CONNBYTES=y
CONFIG_NETFILTER_XT_MATCH_CONNLABEL=y
CONFIG_NETFILTER_XT_MATCH_CONNLIMIT=y
CONFIG_NETFILTER_XT_MATCH_CONNMARK=y
CONFIG_NETFILTER_XT_MATCH_CONNTRACK=y
CONFIG_NETFILTER_XT_MATCH_HASHLIMIT=y
CONFIG_NETFILTER_XT_MATCH_HELPER=y
CONFIG_NETFILTER_XT_MATCH_IPRANGE=y
CONFIG_NETFILTER_XT_MATCH_LENGTH=y
CONFIG_NETFILTER_XT_MATCH_LIMIT=y
CONFIG_NETFILTER_XT_MATCH_MAC=y
CONFIG_NETFILTER_XT_MATCH_MARK=y
CONFIG_NETFILTER_XT_MATCH_OWNER=y
CONFIG_NETFILTER_XT_MATCH_POLICY=y
CONFIG_NETFILTER_XT_MATCH_PKTTYPE=y
CONFIG_NETFILTER_XT_MATCH_QUOTA=y
CONFIG_NETFILTER_XT_MATCH_QUOTA2=y
CONFIG_NETFILTER_XT_MATCH_QUOTA2_LOG=y
CONFIG_NETFILTER_XT_MATCH_SCTP=y
CONFIG_NETFILTER_XT_MATCH_SOCKET=y
CONFIG_NETFILTER_XT_MATCH_STATE=y
CONFIG_NETFILTER_XT_MATCH_STATISTIC=y
CONFIG_NETFILTER_XT_MATCH_STRING=y
CONFIG_NETFILTER_XT_MATCH_TIME=y
CONFIG_NETFILTER_XT_MATCH_U32=y
CONFIG_IP_NF_IPTABLES=y
CONFIG_IP_NF_MATCH_AH=y
CONFIG_IP_NF_MATCH_ECN=y
CONFIG_IP_NF_MATCH_RPFILTER=y
CONFIG_IP_NF_MATCH_TTL=y
CONFIG_IP_NF_FILTER=y
CONFIG_IP_NF_TARGET_REJECT=y
CONFIG_IP_NF_NAT=y
CONFIG_IP_NF_TARGET_MASQUERADE=y
CONFIG_IP_NF_TARGET_NETMAP=y
CONFIG_IP_NF_TARGET_REDIRECT=y
CONFIG_IP_NF_MANGLE=y
CONFIG_IP_NF_RAW=y
CONFIG_IP_NF_SECURITY=y
CONFIG_IP_NF_ARPTABLES=y
CONFIG_IP_NF_ARPFILTER=y
CONFIG_IP_NF_ARP_MANGLE=y
CONFIG_IP6_NF_IPTABLES=y
CONFIG_IP6_NF_MATCH_RPFILTER=y
CONFIG_IP6_NF_FILTER=y
CONFIG_IP6_NF_TARGET_REJECT=y
CONFIG_IP6_NF_MANGLE=y
CONFIG_IP6_NF_RAW=y
CONFIG_IP6_NF_NAT=y
CONFIG_L2TP=y
CONFIG_NET_SCHED=y
CONFIG_NET_SCH_HTB=y
CONFIG_NET_SCH_NETEM=y
CONFIG_NET_SCH_INGRESS=y
CONFIG_NET_CLS_U32=y
CONFIG_NET_CLS_BPF=y
CONFIG_NET_EMATCH=y
CONFIG_NET_EMATCH_U32=y
CONFIG_NET_CLS_ACT=y
CONFIG_NET_ACT_POLICE=y
CONFIG_NET_ACT_GACT=y
CONFIG_NET_ACT_MIRRED=y
CONFIG_UEVENT_HELPER_PATH="/sbin/hotplug"
CONFIG_DEVTMPFS=y
CONFIG_FW_LOADER_USER_HELPER=y
CONFIG_FW_LOADER_USER_HELPER_FALLBACK=y
CONFIG_EXTRA_FIRMWARE="npu/NPU.bin"
CONFIG_EXTRA_FIRMWARE_DIR="./firmware"
CONFIG_DMA_CMA=y
CONFIG_CMA_SIZE_MBYTES=12
CONFIG_BLK_DEV_LOOP=y
CONFIG_BLK_DEV_LOOP_MIN_COUNT=16
CONFIG_BLK_DEV_RAM=y
CONFIG_BLK_DEV_RAM_SIZE=8192
CONFIG_EXYNOS_PASR=y
CONFIG_UID_SYS_STATS=y
CONFIG_VBUS_NOTIFIER=y
CONFIG_USE_MUIC=y
CONFIG_USE_SAFEOUT=y
CONFIG_MUIC_NOTIFIER=y
CONFIG_MUIC_SUPPORT_CCIC=y
CONFIG_MUIC_MAX77705=y
CONFIG_HV_MUIC_MAX77705_AFC=y
CONFIG_MUIC_MAX77705_CCIC=y
CONFIG_HICCUP_CHARGER=y
CONFIG_MAX77705_FW_PID03_SUPPORT=y
CONFIG_SCSI=y
CONFIG_UFS_SRPMB=y
CONFIG_BLK_DEV_SD=y
CONFIG_SCSI_UFSHCD=y
CONFIG_SCSI_UFSHCD_PLATFORM=y
CONFIG_SCSI_UFS_EXYNOS=y
CONFIG_SCSI_UFS_EXYNOS_FMP=y
#CONFIG_SCSI_UFS_TEST_MODE is not set
CONFIG_UFS_DATA_LOG=y
CONFIG_UFS_DATA_LOG_MAGIC_CODE=y
CONFIG_UFSHPB=y
CONFIG_UFSFEATURE=y
CONFIG_HPB_DEBUG_SYSFS=y
CONFIG_MD=y
CONFIG_BLK_DEV_DM=y
CONFIG_DM_CRYPT=y
CONFIG_DM_UEVENT=y
CONFIG_DM_VERITY=y
CONFIG_DM_VERITY_FEC=y
CONFIG_DM_ANDROID_VERITY_AT_MOST_ONCE_DEFAULT_ENABLED=y
CONFIG_DM_BOW=y
CONFIG_DM_DEFAULT_KEY=y
CONFIG_NETDEVICES=y
#WiFi
CONFIG_BROADCOM_WIFI=y
CONFIG_NL80211_TESTMODE=y
CONFIG_BCM4375=y
CONFIG_BCMDHD_FW_PATH=y
CONFIG_BCMDHD_NVRAM_PATH=y
CONFIG_WIRELESS=y
CONFIG_WIRELESS_EXT_SYSFS=y
CONFIG_WEXT_CORE=y
CONFIG_WEXT_PROC=y
CONFIG_CFG80211=y
CONFIG_CFG80211_SAE_BKPORT=y
CONFIG_CFG80211_DEFAULT_PS=y
CONFIG_CFG80211_ALLOW_RECONNECT=y
CONFIG_WLAN=y
CONFIG_WIFI_CONTROL_FUNC=y
CONFIG_BROADCOM_WIFI_RESERVED_MEM=y
CONFIG_CFG80211_REG_NOT_UPDATED=y
CONFIG_WIFI_MULTICAST_LOG=y
CONFIG_BCMDHD_PCIE=y
CONFIG_BCMDHD_PREALLOC_MEMDUMP=y
CONFIG_BCMDHD_OOB_HOST_WAKE=y
CONFIG_WLAN_VENDOR_DUMP_ENABLE=y
CONFIG_TUN=y
CONFIG_PPP=y
CONFIG_PPP_BSDCOMP=y
CONFIG_PPP_DEFLATE=y
CONFIG_PPP_MPPE=y
CONFIG_PPTP=y
CONFIG_PPPOL2TP=y
CONFIG_USB_USBNET=y
CONFIG_INPUT_EVDEV=y
CONFIG_KEYBOARD_GPIO=y
CONFIG_KEYBOARD_SAMSUNG=y
# CONFIG_INPUT_MOUSE is not set
CONFIG_INPUT_JOYSTICK=y
CONFIG_JOYSTICK_XPAD=y
CONFIG_JOYSTICK_XPAD_FF=y
CONFIG_JOYSTICK_XPAD_LEDS=y
CONFIG_INPUT_TABLET=y
CONFIG_TABLET_USB_ACECAD=y
CONFIG_TABLET_USB_AIPTEK=y
CONFIG_TABLET_USB_GTCO=y
CONFIG_TABLET_USB_HANWANG=y
CONFIG_TABLET_USB_KBTAB=y
CONFIG_INPUT_TOUCHSCREEN=y
CONFIG_SEC_DEBUG_TSP_LOG=y
CONFIG_TOUCHSCREEN_DUMP_MODE=y
CONFIG_INPUT_MISC=y
CONFIG_INPUT_UINPUT=y
# CONFIG_SERIO_SERPORT is not set
# CONFIG_VT is not set
# CONFIG_LEGACY_PTYS is not set
CONFIG_SERIAL_SAMSUNG=y
CONFIG_SERIAL_SAMSUNG_CONSOLE=y
CONFIG_HW_RANDOM=y
CONFIG_EXYRNG_FIPS_COMPLIANCE=y
CONFIG_EXYRNG_FAIL_POLICY_RESET=y
CONFIG_EXYRNG_USE_CRYPTOMANAGER=y
CONFIG_I2C_CHARDEV=y
CONFIG_SPI=y
CONFIG_SPI_S3C64XX=y
CONFIG_GPIOLIB=y
CONFIG_GPIO_SYSFS=y
CONFIG_HWMON=y
CONFIG_SENSORS_SEC_THERMISTOR=y
CONFIG_THERMAL=y
CONFIG_THERMAL_STATISTICS=y
CONFIG_THERMAL_WRITABLE_TRIPS=y
CONFIG_THERMAL_GOV_POWER_ALLOCATOR=y
CONFIG_CPU_THERMAL=y
CONFIG_GPU_THERMAL=y
CONFIG_ISP_THERMAL=y
CONFIG_THERMAL_EMULATION=y
CONFIG_EXYNOS_THERMAL_V2=y
CONFIG_EXYNOS_ACPM_THERMAL=y
CONFIG_WATCHDOG=y
CONFIG_S3C2410_WATCHDOG=y
CONFIG_S3C2410_SHUTDOWN_REBOOT=y
CONFIG_SEC_DEBUG_EXCEPTION_STACK=y
CONFIG_MFD_MAX77705=y
CONFIG_MFD_SEC_CORE=y
CONFIG_MFD_S2MPS19=y
CONFIG_MFD_S2MPS22=y
CONFIG_MFD_S2MPB02=y
CONFIG_REGULATOR_FIXED_VOLTAGE=y
CONFIG_DRV_SAMSUNG_PMIC=y
CONFIG_REGULATOR_S2MPS19=y
CONFIG_REGULATOR_S2MPS22=y
CONFIG_REGULATOR_S2MPB02=y
CONFIG_REGULATOR_S2MPB03=y
CONFIG_REGULATOR_S2DOS05=y
CONFIG_MEDIA_SUPPORT=y
CONFIG_V4L_PLATFORM_DRIVERS=y
CONFIG_VIDEO_EXYNOS_MFC=y
CONFIG_VIDEO_EXYNOS_PABLO_ISP=y
CONFIG_CSIS_V5_3=y
CONFIG_SENSOR_RETENTION_USE=y
CONFIG_CAMERA_CIS_3J1_OBJ=y
CONFIG_CAMERA_CIS_2LA_OBJ=y
CONFIG_CAMERA_CIS_2LD_OBJ=y
CONFIG_CAMERA_CIS_GW2_OBJ=y
CONFIG_CAMERA_ACT_AK737X_OBJ=y
CONFIG_CAMERA_FLASH_S2MPB02_OBJ=y
CONFIG_CAMERA_EEPROM_SUPPORT_REAR=y
CONFIG_CAMERA_EEPROM_SUPPORT_FRONT=y
CONFIG_LEDS_S2MPB02=y
CONFIG_TORCH_CURRENT_CHANGE_SUPPORT=y
CONFIG_FLASH_CURRENT_CHANGE_SUPPORT=y
CONFIG_VENDER_MCD=y
CONFIG_OIS_USE=y
CONFIG_CAMERA_USE_INTERNAL_MCU=y
CONFIG_AF_HOST_CONTROL=y
CONFIG_VIDEO_EXYNOS_CAMERA_POSTPROCESS=y
CONFIG_CAMERA_PP_GDC_V3_1_0_OBJ=y
CONFIG_VIDEO_EXYNOS_REPEATER=y
CONFIG_VIDEO_EXYNOS_TSMUX=y
CONFIG_V4L_MEM2MEM_DRIVERS=y
CONFIG_VIDEO_EXYNOS_SMFC=y
CONFIG_VIDEO_EXYNOS_SCALER=y
CONFIG_MALI_MIDGARD=y
CONFIG_MALI_EXPERT=y
CONFIG_EXYNOS_SOC_NAME="9830"
CONFIG_EXYNOS_GRAPHICS_G2D=y
# CONFIG_G2D_SYSTRACE is not set
CONFIG_FB=y
CONFIG_FB_MODE_HELPERS=y
CONFIG_FB_SIMPLE=y
CONFIG_EXYNOS_DPU30=y
CONFIG_EXYNOS_DISPLAYPORT=y
CONFIG_HDCP2_FUNC_TEST_MODE=y
CONFIG_SEC_DISPLAYPORT_LOGGER=y
CONFIG_USE_DISPLAYPORT_CCIC_EVENT_QUEUE=y
CONFIG_EXYNOS_WINDOW_UPDATE=y
CONFIG_EXYNOS_HIBERNATION=y
CONFIG_EXYNOS_HIBERNATION_EARLY_WAKEUP=y
CONFIG_EXYNOS_DOZE=y
CONFIG_EXYNOS_DOZE_HIBERNATION=y
CONFIG_EXYNOS_MULTIRESOLUTION=y
CONFIG_DECON_BTS_LEGACY=y
CONFIG_EXYNOS_PLL_SLEEP=y
CONFIG_EXYNOS_EWR=y
CONFIG_EXYNOS_SUPPORT_READBACK=y
CONFIG_EXYNOS_COMMON_PANEL=y
CONFIG_BACKLIGHT_LCD_SUPPORT=y
CONFIG_LCD_CLASS_DEVICE=y
CONFIG_BACKLIGHT_CLASS_DEVICE=y
# CONFIG_BACKLIGHT_GENERIC is not set
CONFIG_SOUND=y
CONFIG_SND=y
CONFIG_SND_DYNAMIC_MINORS=y
CONFIG_SND_USB_AUDIO=y
CONFIG_SND_EXYNOS_USB_AUDIO=y
CONFIG_SND_SOC=y
CONFIG_SND_SOC_SAMSUNG=y
CONFIG_SND_SOC_SAMSUNG_EXYNOS9830_CS35L41_I2C=y
CONFIG_SND_SOC_SAMSUNG_EXYNOS9830_MADERA=y
CONFIG_HIDRAW=y
CONFIG_UHID=y
CONFIG_HID_A4TECH=y
CONFIG_HID_ACRUX=y
CONFIG_HID_ACRUX_FF=y
CONFIG_HID_APPLE=y
CONFIG_HID_BELKIN=y
CONFIG_HID_CHERRY=y
CONFIG_HID_CHICONY=y
CONFIG_HID_PRODIKEYS=y
CONFIG_HID_CYPRESS=y
CONFIG_HID_DRAGONRISE=y
CONFIG_DRAGONRISE_FF=y
CONFIG_HID_EMS_FF=y
CONFIG_HID_ELECOM=y
CONFIG_HID_EZKEY=y
CONFIG_HID_HOLTEK=y
CONFIG_HID_KEYTOUCH=y
CONFIG_HID_KYE=y
CONFIG_HID_UCLOGIC=y
CONFIG_HID_WALTOP=y
CONFIG_HID_GYRATION=y
CONFIG_HID_TWINHAN=y
CONFIG_HID_KENSINGTON=y
CONFIG_HID_LCPOWER=y
CONFIG_HID_LOGITECH=y
CONFIG_HID_LOGITECH_DJ=y
CONFIG_LOGITECH_FF=y
CONFIG_LOGIRUMBLEPAD2_FF=y
CONFIG_LOGIG940_FF=y
CONFIG_HID_MAGICMOUSE=y
CONFIG_HID_MICROSOFT=y
CONFIG_HID_MONTEREY=y
CONFIG_HID_MULTITOUCH=y
CONFIG_HID_NTRIG=y
CONFIG_HID_ORTEK=y
CONFIG_HID_PANTHERLORD=y
CONFIG_PANTHERLORD_FF=y
CONFIG_HID_PETALYNX=y
CONFIG_HID_PICOLCD=y
CONFIG_HID_PRIMAX=y
CONFIG_HID_ROCCAT=y
CONFIG_HID_SAITEK=y
CONFIG_HID_SAMSUNG=y
CONFIG_HID_SONY=y
CONFIG_HID_SPEEDLINK=y
CONFIG_HID_SUNPLUS=y
CONFIG_HID_GREENASIA=y
CONFIG_GREENASIA_FF=y
CONFIG_HID_SMARTJOYPLUS=y
CONFIG_SMARTJOYPLUS_FF=y
CONFIG_HID_TIVO=y
CONFIG_HID_TOPSEED=y
CONFIG_HID_THRUSTMASTER=y
CONFIG_HID_WACOM=y
CONFIG_HID_WIIMOTE=y
CONFIG_HID_ZEROPLUS=y
CONFIG_HID_ZYDACRON=y
CONFIG_USB_HIDDEV=y
CONFIG_USB_ANNOUNCE_NEW_DEVICES=y
CONFIG_USB_OTG=y
CONFIG_USB_XHCI_HCD=y
CONFIG_USB_XHCI_ALLOC_FROM_DMA_POOL=y
CONFIG_USB_PRINTER=y
CONFIG_USB_STORAGE=y
CONFIG_USB_STORAGE_DETECT=y
CONFIG_USB_HOST_NOTIFY=y
CONFIG_USB_HOST_SAMSUNG_FEATURE=y
CONFIG_USB_LINK_LAYER_TEST=y
CONFIG_USB_EHSET_TEST_FIXTURE=y
CONFIG_USB_NOTIFY_LAYER=y
CONFIG_USB_NOTIFY_PROC_LOG=y
CONFIG_USB_DEBUG_DETAILED_LOG=y
CONFIG_USB_EXTERNAL_NOTIFY=y
CONFIG_USB_NOTIFIER=y
CONFIG_USB_HW_PARAM=y
CONFIG_USB_INTERFACE_LPM_LIST=y
CONFIG_USB_TYPEC_MANAGER_NOTIFIER=y
CONFIG_IF_CB_MANAGER=y
CONFIG_USB_DWC3=y
CONFIG_USB_DWC3_DUAL_ROLE=y
CONFIG_USB_GADGET=y
CONFIG_USB_CONFIGFS=y
CONFIG_USB_OLD_CONFIGFS=y
CONFIG_USB_CONFIGFS_UEVENT=y
CONFIG_USB_CONFIGFS_ACM=y
CONFIG_USB_CONFIGFS_RNDIS=y
CONFIG_USB_CONFIGFS_F_FS=y
CONFIG_USB_CONFIGFS_F_CONN_GADGET=y
CONFIG_USB_CONFIGFS_F_DM=y
CONFIG_USB_CONFIGFS_F_MTP=y
CONFIG_USB_CONFIGFS_F_PTP=y
CONFIG_USB_CONFIGFS_F_ACC=y
CONFIG_USB_CONFIGFS_F_AUDIO_SRC=y
CONFIG_USB_CONFIGFS_NCM=y
CONFIG_USB_NCM_SUPPORT_MTU_CHANGE=y
CONFIG_USB_G_ANDROID=y
CONFIG_USB_ANDROID_SAMSUNG_COMPOSITE=y
CONFIG_USB_DUN_SUPPORT=y
CONFIG_USB_RNDIS_MULTIPACKET=y
CONFIG_USB_CONFIGFS_F_MIDI=y
CONFIG_USB_ACM=y
CONFIG_USB_NET_SMSC75XX=y
CONFIG_USB_NET_SMSC95XX=y
CONFIG_USB_RTL8152=y
CONFIG_USB_RTL8150=y
CONFIG_USB_NET_CDC_EEM=y
CONFIG_USB_NET_CDC_MBIM=y
CONFIG_USB_SERIAL=y
CONFIG_USB_SERIAL_FTDI_SIO=y
CONFIG_USB_SERIAL_PL2303=y
CONFIG_SONY_FF=y
CONFIG_HID_PLANTRONICS=y
CONFIG_MMC=y
CONFIG_MMC_DW=y
CONFIG_MMC_DW_IDMAC=y
CONFIG_MMC_DW_64BIT_DESC=y
CONFIG_MMC_DW_EXYNOS=y
CONFIG_MMC_DW_DEBUG=y
CONFIG_MMC_DW_FORCE_32BIT_SFR_RW=y
CONFIG_RTC_CLASS=y
CONFIG_RTC_DRV_S2MPS19=y
CONFIG_DMADEVICES=y
CONFIG_STAGING=y
CONFIG_ASHMEM=y
CONFIG_ION=y
CONFIG_ION_EXYNOS=y
CONFIG_ION_SYSTEM_HEAP=y
CONFIG_ION_CARVEOUT_HEAP=y
CONFIG_ION_CMA_HEAP=y
CONFIG_ION_HPA_HEAP=y
CONFIG_ANDROID_SWITCH=y
CONFIG_EXYNOS_CHIPID=y
CONFIG_EXYNOS_SCI=y
CONFIG_EXYNOS_BCM_DBG=y
CONFIG_CAL_IF=y
CONFIG_EXYNOS_REBOOT=y
# CONFIG_CMUCAL_DEBUG is not set
CONFIG_CMUCAL_QCH_IGNORE_SUPPORT=y
CONFIG_EXYNOS_ACPM=y
CONFIG_FLEXPMU=y
CONFIG_EXYNOS_CPUPM=y
CONFIG_EXYNOS_PD=y
CONFIG_ECT=y
CONFIG_ECT_DUMP=y
CONFIG_EXYNOS_RGT=y
CONFIG_EXYNOS_CORESIGHT=y
CONFIG_EXYNOS_ADV_TRACER=y
CONFIG_EXYNOS_ADV_TRACER_S2D=y
# CONFIG_EXYNOS_ADV_TRACER_EHLD is not set
# CONFIG_EXYNOS_EHLD is not set
CONFIG_EXYNOS_DVFS_MANAGER=y
CONFIG_EXYNOS_OCP=y
CONFIG_SHM_IPC=y
CONFIG_EXYNOS_MODEM_IF=y
CONFIG_SEC_MODEM_S5100=y
CONFIG_NF_HISTORY=y
CONFIG_HW_FORWARD=y
CONFIG_PM_DEVFREQ=y
CONFIG_DEVFREQ_GOV_SIMPLE_INTERACTIVE=y
CONFIG_EXYNOS_ALT_DVFS=y
CONFIG_ARM_EXYNOS_DEVFREQ=y
CONFIG_ARM_EXYNOS_DEVFREQ_DEBUG=y
CONFIG_EXTCON=y
CONFIG_IIO=y
CONFIG_EXYNOS_ADC=y
CONFIG_PWM=y
CONFIG_PWM_SAMSUNG=y
CONFIG_PHY_EXYNOS_MIPI=y
CONFIG_ANDROID=y
CONFIG_ANDROID_BINDER_IPC=y
CONFIG_EXYNOS_BTS=y
CONFIG_CCIC_NOTIFIER=y
CONFIG_CCIC_MAX77705=y
CONFIG_BATTERY_SAMSUNG=y
CONFIG_BATTERY_SWELLING=y
CONFIG_CALC_TIME_TO_FULL=y
CONFIG_BATTERY_AGE_FORECAST=y
CONFIG_AFC_CHARGER_MODE=y
CONFIG_BATTERY_NOTIFIER=y
CONFIG_BATTERY_SAMSUNG_V2=y
CONFIG_FUELGAUGE_MAX77705=y
CONFIG_CHARGER_MAX77705=y
CONFIG_SWITCH=y
CONFIG_EXT2_FS=y
CONFIG_EXT3_FS=y
CONFIG_EXT4_FS_SECURITY=y
CONFIG_EXT4_ENCRYPTION=y
CONFIG_F2FS_FS=y
CONFIG_F2FS_FS_SECURITY=y
CONFIG_F2FS_FS_ENCRYPTION=y
CONFIG_QUOTA=y
CONFIG_QUOTA_NETLINK_INTERFACE=y
CONFIG_QFMT_V2=y
CONFIG_FUSE_FS=y
CONFIG_OVERLAY_FS=y
CONFIG_MSDOS_FS=y
CONFIG_VFAT_FS=y
CONFIG_TMPFS=y
CONFIG_TMPFS_POSIX_ACL=y
CONFIG_CRAMFS=y
CONFIG_PSTORE=y
CONFIG_PSTORE_CONSOLE=y
CONFIG_PSTORE_PMSG=y
CONFIG_PSTORE_RAM=y
CONFIG_NLS_CODEPAGE_437=y
CONFIG_NLS_ISO8859_1=y
CONFIG_SECURITY_PERF_EVENTS_RESTRICT=y
#CONFIG_SECURITY=y
CONFIG_HARDENED_USERCOPY=y
CONFIG_CRYPTO_GCM=y
CONFIG_CRYPTO_SHA512=y
CONFIG_CRYPTO_DISKCIPHER=y
# CONFIG_CRYPTO_DISKCIPHER_DEBUG is not set
CONFIG_CRYPTO_KBKDF_CTR_HMAC_SHA512=y
CONFIG_EXYNOS_FMP=y
CONFIG_EXYNOS_FMP_FIPS=y
# SEC NAD
CONFIG_SEC_NAD=y
CONFIG_SEC_NAD_LOG=y
CONFIG_SEC_NAD_X=y
CONFIG_SEC_NAD_C=y
CONFIG_SEC_SUPPORT_SECOND_NAD=y
# CONFIG_SEC_NAD_BALANCER is not set
CONFIG_SEC_SUPPORT_VST=y
# CONFIG_SEC_NAD_API is not set
CONFIG_PRINTK_TIME=y
CONFIG_PRINTK_PROCESS=y
CONFIG_DEBUG_INFO=y
CONFIG_FRAME_WARN=4096
CONFIG_MAGIC_SYSRQ=y
# CONFIG_DEBUG_VM is not set
# CONFIG_DEBUG_VM_PGFLAGS is not set
# CONFIG_DEBUG_PER_CPU_MAPS is not set
CONFIG_SOFTLOCKUP_DETECTOR=y
CONFIG_BOOTPARAM_SOFTLOCKUP_PANIC=y
CONFIG_BOOTPARAM_HARDLOCKUP_PANIC=y
CONFIG_BOOTPARAM_HUNG_TASK_PANIC=y
# CONFIG_WQ_WATCHDOG is not set
CONFIG_PANIC_ON_OOPS=y
CONFIG_PANIC_TIMEOUT=5
CONFIG_SCHEDSTATS=y
# CONFIG_DEBUG_PREEMPT is not set
# CONFIG_DEBUG_LOCK_ALLOC is not set
# CONFIG_DEBUG_ATOMIC_SLEEP is not set
CONFIG_ENABLE_DEFAULT_TRACERS=y
CONFIG_ATOMIC64_SELFTEST=y
# CONFIG_BUG_ON_DATA_CORRUPTION is not set
CONFIG_DEBUG_SNAPSHOT=y
CONFIG_DEBUG_SNAPSHOT_REG=y
CONFIG_DEBUG_SNAPSHOT_USER_MODE=y
CONFIG_EXYNOS_KERNEL_PROTECTION=y
CONFIG_VISION_SUPPORT=y
CONFIG_EXYNOS_DSP=y
CONFIG_EXYNOS_DSP_EXYNOS9830=y
CONFIG_EXYNOS_ENABLE_HDCP2=y
CONFIG_VISION_CORE=y
CONFIG_VISION_UNITTEST=y
CONFIG_EXYNOS_NPU=y
CONFIG_EXYNOS_NPU_PUBLISH_NPU_BUILD_VER=y
CONFIG_EXYNOS_NPU_DEBUG_SRAM_DUMP=y
CONFIG_NPU_INTERFACE=y
CONFIG_NPU_HARDWARE=y
CONFIG_NPU_USE_MBR=y

# CONFIG_DEVMEM is not set

# [ SEC_SELINUX_PORTING_COMMON
CONFIG_EXT2_FS_XATTR=y
CONFIG_EXT2_FS_SECURITY=y
CONFIG_EXT4_FS_XATTR=y
#CONFIG_EXT4_FS_SECURITY=y
#CONFIG_AUDIT=y
CONFIG_SECURITY=y
CONFIG_LSM_MMAP_MIN_ADDR=4096
CONFIG_SECURITY_NETWORK=y
CONFIG_SECURITY_SELINUX=y
CONFIG_DEFAULT_SECURITY_SELINUX=y
CONFIG_NETWORK_SECMARK=y
CONFIG_AUDITSYSCALL=y
CONFIG_PROC_AVC=y
CONFIG_SDCARD_FS_XATTR=y
CONFIG_ECRYPT_FS_VIRTUAL_FAT_XATTR=y
CONFIG_FAT_VIRTUAL_XATTR=y
CONFIG_EXFAT_VIRTUAL_XATTR=y
# ] SEC_SELINUX_PORTING_COMMON

#BT
CONFIG_BT=y
CONFIG_RFKILL=y
CONFIG_BT_BCM43XX=y

# dev ril bridge
CONFIG_DEV_RIL_BRIDGE=y

# HQM Feature
CONFIG_SEC_HQM_DEVICE=y

# NFC
CONFIG_SAMSUNG_NFC=y
CONFIG_SEC_NFC=y
CONFIG_SEC_NFC_LOGGER=y
CONFIG_ESE_P3_LSI=y
CONFIG_ESE_COLDRESET=y
CONFIG_SNVM_K250A=y
# CONFIG_ESE_SECURE is not set
# CONFIG_ESE_SECURE_SPI_PORT is not set
# CONFIG_ESE_SECURE_USI_MODE is not set

# SensorHub
CONFIG_IIO_BUFFER=y
CONFIG_IIO_KFIFO_BUF=y
CONFIG_GPS_BCM4773=y
CONFIG_SENSORS_SSP_BBD=y
CONFIG_SENSORS_SSP=y
CONFIG_SENSORS_SYSFS=y
CONFIG_SENSORS_SSP_SENSORHUB=y
CONFIG_SENSORS_SSP_FACTORY=y
CONFIG_SENSORS_SSP_LSM6DSO=y
CONFIG_SENSORS_SSP_LPS22H=y
CONFIG_SENSORS_SSP_MAGNETIC_COMMON=y
CONFIG_SENSORS_SSP_TMD4907=y
CONFIG_SENSORS_SSP_IRDATA_FOR_CAMERA=y
CONFIG_SENSORS_SSP_INTERRUPT_GYRO_SENSOR=y
#CONFIG_SENSORS_SSP_PROX_FACTORYCAL=y
CONFIG_SENSORS_SSP_PROX_AUTOCAL_AMS=y
CONFIG_SENSORS_SSP_MOBEAM=y
CONFIG_SENSORS_MULTIPLE_GLASS_TYPE=y
CONFIG_SENSORS_SSP_HIFI_BATCHING=y
CONFIG_SENSORS_SSP_LIGHT_REPORT_LUX=y
CONFIG_SENSORS_SSP_LIGHT_COLORID=y
CONFIG_SSP_MOTOR_CALLBACK=y
CONFIG_SENSORS_SSP_THERMISTOR=y
CONFIG_SSP_SUPPORT_MAGNETIC_OVERFLOW=y
CONFIG_SENSORS_SSP_LIGHT_MAX_GAIN_2BYTE=y
CONFIG_SENSORS_SSP_LIGHT_MAX_ATIME_2BYTE=y
CONFIG_SENSORS_SSP_LIGHT_ADDING_LUMINANCE=y
CONFIG_SENSORS_SSP_LIGHT_LUX_RAW=y
CONFIG_SENSORS_SSP_PROX_LIGHT_DIFF=y

# Fingerprint
CONFIG_SENSORS_FINGERPRINT=y
CONFIG_SENSORS_FP_SPI_NUMBER=4
CONFIG_SENSORS_FP_USI_NUMBER=8

# TCP congestion algorithm
CONFIG_TCP_CONG_ADVANCED=y
CONFIG_TCP_CONG_BIC=y
CONFIG_DEFAULT_BIC=y
CONFIG_DEFAULT_TCP_CONG="bic"

# UFS turbo write
CONFIG_BLK_IO_VOLUME=y
CONFIG_BLK_TURBO_WRITE=y

# Throughput monitoring Feature
CONFIG_ARGOS=y
CONFIG_ARGOS_CLUSTER_NUM=3

#BarTender
CONFIG_FAIR_GROUP_SCHED=y
CONFIG_CFS_BANDWIDTH=y

# SWAP
CONFIG_ZSMALLOC=y
CONFIG_PGTABLE_MAPPING=y
CONFIG_ZRAM=y

# BLOCK
CONFIG_LARGE_DIRTY_BUFFER=y
CONFIG_MAX_DIRTY_THRESH_PAGES=25600

# ODE and DIR Encryption
#
CONFIG_CRYPTO=y
CONFIG_CRYPTO_SHA1=y
CONFIG_CRYPTO_SHA256=y
CONFIG_CRYPTO_AES=y
CONFIG_CRYPTO_CBC=y
CONFIG_ECRYPT_FS=y
CONFIG_ECRYPT_FS_MESSAGING=y
CONFIG_WTL_ENCRYPTION_FILTER=y
CONFIG_KEYS=y
CONFIG_KEYS_DEBUG_PROC_KEYS=y
CONFIG_ECRYPTFS_FEK_INTEGRITY=y

# DEBUG
CONFIG_DEBUG_OBJECTS=y
CONFIG_DEBUG_OBJECTS_FREE=y
CONFIG_DEBUG_OBJECTS_TIMERS=y
CONFIG_DEBUG_OBJECTS_WORK=y
CONFIG_DEBUG_OBJECTS_RCU_HEAD=y
CONFIG_DEBUG_OBJECTS_PERCPU_COUNTER=y
CONFIG_SLUB_DEBUG=y

# KALLSYMS_ALL
CONFIG_KALLSYMS_ALL=y

# STI
CONFIG_SEC_STI=y
# ABC
CONFIG_SEC_ABC=y
# CONFIG_SEC_ABC_HUB is not set
# CONFIG_SEC_ABC_HUB_COND is not set
CONFIG_SEC_ABC_HUB_BOOTC=y

# FIPS
CONFIG_CRYPTO_FIPS=y
CONFIG_CRYPTO_KBKDF_CTR_HMAC_SHA512=y
CONFIG_ARM64_CRYPTO=y
CONFIG_CRYPTO_SHA1_ARM64_CE=y
CONFIG_CRYPTO_SHA2_ARM64_CE=y
CONFIG_CRYPTO_AES_ARM64_CE
CONFIG_CRYPTO_AES_ARM64_CE_BLK=y

#EPDG
CONFIG_NET_CORE=y
CONFIG_NET_SCH_PRIO=y
#CONFIG_NET_SCHED=y   #depends on CONFIG_NET  which is enabled by default.. coz not seeing in the config file
CONFIG_NET_CLS_BASIC=y # required if basic is being used as a filter. depends on CONFIG_NET_CLS so enabling it by default
CONFIG_NET_CLS=y
#CONFIG_NET_CLS_ACT=y # for enabling the action target.
#CONFIG_NET_ACT_MIRRED=y  # for enabling the mirred target for redirecting the packet between the devices.
#CONFIG_NET_EMATCH=y   #basic uses extended matches so this has to be present
#CONFIG_NET_SCH_INGRESS=y # classifier for ingress packet
#EPDG

# FFSI governor abstraction
CONFIG_FFSI=y
CONFIG_SCHED_FFSI_GLUE=y

# UH
CONFIG_UH_LKM_BLOCK=y

# UFS turbo write
CONFIG_BLK_IO_VOLUME=y
CONFIG_BLK_TURBO_WRITE=y
```
