## arch/arm64/configs/exynos9810-ubsan_defconfig
```kconfig
#
# Kernel Performance Events and Counters
#
#
CONFIG_UBSAN=y
CONFIG_SEC_DEBUG_UBSAN=y
CONFIG_LOG_BUF_SHIFT=21

#
# Undefined config for Kernel SANitizers
#
# CONFIG_UH_RKP is not set
# CONFIG_RKP_CFP_JOPP is not set

#
# DO NOT REMOVE THE LAST BLANK LINE
#
```

## arch/arm64/configs/exynos9810-userdebug_defconfig
```kconfig
CONFIG_SEC_GPIO_DVS=y
CONFIG_USE_SIGNED_BINARY=n

# CONFIG_RKP_KDP is not set
# CONFIG_RKP_NS_PROT is not set

#
# Samsung Rooting Restriction Feature
#
# CONFIG_SEC_RESTRICT_ROOTING is not set
# CONFIG_SEC_RESTRICT_SETUID is not set
# CONFIG_SEC_RESTRICT_FORK is not set
# CONFIG_SEC_RESTRICT_ROOTING_LOG is not set

#
# DS5 enable setup
#
CONFIG_HW_PERF_EVENTS=y
CONFIG_MALI_GATOR_SUPPORT=y
CONFIG_GATOR_WITH_MALI_SUPPORT=y
CONFIG_GATOR_MALI_MIDGARD=y
CONFIG_GATOR=y
```

## arch/arm64/configs/exynos9820-eng_defconfig
```kconfig
#
# Kernel Performance Events and Counters
#
CONFIG_SLUB_DEBUG=y

#
# printk and dmesg options
#
CONFIG_DYNAMIC_DEBUG=y
# CONFIG_PAGE_OWNER is not set

# Memory Debugging
#
CONFIG_DEBUG_PAGEALLOC=y
CONFIG_DEBUG_PAGEALLOC_ENABLE_DEFAULT=y
CONFIG_PAGE_POISONING=y
CONFIG_DEBUG_RODATA_TEST=y
CONFIG_DEBUG_OBJECTS=y
CONFIG_DEBUG_OBJECTS_FREE=y
CONFIG_DEBUG_OBJECTS_TIMERS=y
CONFIG_DEBUG_OBJECTS_WORK=y
CONFIG_DEBUG_OBJECTS_RCU_HEAD=y
CONFIG_DEBUG_OBJECTS_PERCPU_COUNTER=y
CONFIG_DEBUG_PER_CPU_MAPS=y
CONFIG_SLUB_DEBUG_ON=y
CONFIG_DEBUG_KMEMLEAK=y
CONFIG_DEBUG_KMEMLEAK_EARLY_LOG_SIZE=8192
CONFIG_DEBUG_KMEMLEAK_DEFAULT_OFF=y
CONFIG_DEBUG_STACK_USAGE=y
CONFIG_DEBUG_MEMORY_INIT=y
CONFIG_PTRACK_DEBUG=y

#
# Debug Lockups and Hangs
#
CONFIG_SCHEDSTATS=y
CONFIG_SCHED_STACK_END_CHECK=y
CONFIG_TIMER_STATS=y
CONFIG_DEBUG_PREEMPT=y

#
# Lock Debugging (spinlocks, mutexes, etc...)
#
CONFIG_DEBUG_RT_MUTEXES=y
CONFIG_DEBUG_SPINLOCK=y
CONFIG_DEBUG_MUTEXES=y
# CONFIG_DEBUG_LOCK_ALLOC is not set
# CONFIG_PROVE_LOCKING is not set
CONFIG_DEBUG_LIST=y
CONFIG_DEBUG_PI_LIST=y
CONFIG_DEBUG_SG=y

#
# DS5 enable setup
#
CONFIG_HW_PERF_EVENTS=y
CONFIG_MALI_GATOR_SUPPORT=y
CONFIG_GATOR_WITH_MALI_SUPPORT=y
CONFIG_GATOR=y

#
# Runtime Testing
#
CONFIG_LKDTM=y
CONFIG_ATOMIC64_SELFTEST=y
# CONFIG_DEBUG_RODATA is not set

CONFIG_SEC_GPIO_DVS=y
CONFIG_USE_SIGNED_BINARY=n

#
# Memory Watcher & MMIO Trace
#
# CONFIG_SEC_MMIOTRACE is not set
CONFIG_SEC_KWATCHER=y

#
# Battery driver
#
CONFIG_ENG_BATTERY_CONCEPT=y

#
# Support T32 onchip breakpoint
#
CONFIG_SKIP_HW_BREAKPOINT=y

#
# UFS Journal Data Tag Debug
#
CONFIG_JOURNAL_DATA_TAG_DEBUG=y

#
# SENSORHUB Debug
#
CONFIG_SSP_REGISTER_RW=y

#
# Diplayport eng mode
#
CONFIG_DISPLAYPORT_ENG=y

#
# Maxim 77705 USBC Debug
#
CONFIG_CCIC_MAX77705_DEBUG=y

#
# ABC Hub bootc eng mode
#
CONFIG_SEC_ABC_HUB_BOOTC_ENG=y

# Rooting prevention
#
# CONFIG_SEC_RESTRICT_ROOTING is not set
# CONFIG_SEC_RESTRICT_SETUID is not set
# CONFIG_SEC_RESTRICT_FORK is not set
# CONFIG_SEC_RESTRICT_ROOTING_LOG is not set

# SDP KeyManagement Test for MDFPP evaluation
CONFIG_SDP_KEY_DUMP=y

#
# Micro Hypervisor eng policy
#
# CONFIG_UH_LKMAUTH is not set
# CONFIG_UH_LKM_BLOCK is not set
# CONFIG_RKP_KDP is not set
# CONFIG_RKP_NS_PROT is not set
CONFIG_UH_DEBUG=y
CONFIG_UH_RKP_FIMC_CHECK=y

#
# DO NOT REMOVE THE LAST BLANK LINE
#
```

## arch/arm64/configs/exynos9820-kasan_defconfig
```kconfig
#
# Kernel Performance Events and Counters
#
CONFIG_SLUB_DEBUG=y

#
# KASAN Kernel Address SANitizer
#
CONFIG_KASAN=y
CONFIG_KASAN_INLINE=y
CONFIG_LOG_BUF_SHIFT=21
CONFIG_CC_OPTIMIZE_FOR_SIZE=y

#
# Undefined config for Kernel SANitizers
#
# CONFIG_UH is not set
# CONFIG_UH_RKP is not set
# CONFIG_RKP_CFP_JOPP is not set
# CONFIG_RKP_KDP is not set
# CONFIG_RKP_NS_PROT is not set

# CONFIG_VIDEO_EXYNOS_FIMC_IS2 is not set
# CONFIG_LEDS_S2MPB02 is not set
# CONFIG_SENSORS_TCS3407 is not set

#
# DO NOT REMOVE THE LAST BLANK LINE
#
```

## arch/arm64/configs/exynos9820-ubsan_defconfig
```kconfig
#
# Kernel Performance Events and Counters
#
#
CONFIG_UBSAN=y
CONFIG_LOG_BUF_SHIFT=21

#
# Undefined config for Kernel SANitizers
#
# CONFIG_UH is not set
# CONFIG_UH_RKP is not set
# CONFIG_RKP_CFP_JOPP is not set
# CONFIG_RKP_KDP is not set
# CONFIG_RKP_NS_PROT is not set

#
# DO NOT REMOVE THE LAST BLANK LINE
#
```

## arch/arm64/configs/exynos9820-userdebug_defconfig
```kconfig
CONFIG_SEC_GPIO_DVS=y
CONFIG_USE_SIGNED_BINARY=n

# CONFIG_RKP_KDP is not set
# CONFIG_RKP_NS_PROT is not set
CONFIG_UH_RKP_FIMC_CHECK=y

#
# Samsung Rooting Restriction Feature
#
# CONFIG_SEC_RESTRICT_ROOTING is not set
# CONFIG_SEC_RESTRICT_SETUID is not set
# CONFIG_SEC_RESTRICT_FORK is not set
# CONFIG_SEC_RESTRICT_ROOTING_LOG is not set

#
# DS5 enable setup
#
CONFIG_HW_PERF_EVENTS=y
CONFIG_MALI_GATOR_SUPPORT=y
CONFIG_GATOR_WITH_MALI_SUPPORT=y
CONFIG_GATOR=y
CONFIG_PROFILING=y
CONFIG_PERF_EVENTS=y
CONFIG_HIGH_RES_TIMERS=y
```
