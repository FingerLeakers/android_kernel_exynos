## arch/arm64/configs/exynos9830-eng_defconfig
```kconfig
#
# please don't remove new line on this file
#

CONFIG_USE_SIGNED_BINARY=n

CONFIG_SEC_GPIO_DVS=y
# CONFIG_DEBUG_SNAPSHOT_USER_MODE is not set
# CONFIG_EXYNOS_KERNEL_PROTECTION is not set
CONFIG_CGROUP_DEBUG=y
CONFIG_CMUCAL_DEBUG=y
CONFIG_DEBUG_VM=y
CONFIG_DEBUG_VM_PGFLAGS=y
CONFIG_DEBUG_PER_CPU_MAPS=y
CONFIG_DEBUG_LOCK_ALLOC=y
CONFIG_DEBUG_ATOMIC_SLEEP=y
CONFIG_BUG_ON_DATA_CORRUPTION=y
CONFIG_WQ_WATCHDOG=y
CONFIG_EXYNOS_EHLD=y
CONFIG_EXYNOS_ADV_TRACER_EHLD=y
CONFIG_G2D_SYSTRACE=y
CONFIG_CRYPTO_DISKCIPHER_DEBUG=y
CONFIG_SLUB_DEBUG=y
CONFIG_DEBUG_PREEMPT=y

#
# Battery driver
#
CONFIG_ENG_BATTERY_CONCEPT=y

# Memory Debugging
#
CONFIG_CMA_DEBUGFS=y
CONFIG_DEBUG_RODATA_TEST=y
CONFIG_SLUB_DEBUG_ON=y
CONFIG_DEBUG_PAGEALLOC=y
CONFIG_DEBUG_PAGEALLOC_ENABLE_DEFAULT=y
CONFIG_PAGE_POISONING=y
CONFIG_DEBUG_KMEMLEAK=y
CONFIG_DEBUG_KMEMLEAK_EARLY_LOG_SIZE=8192
CONFIG_DEBUG_KMEMLEAK_DEFAULT_OFF=y
CONFIG_DEBUG_MEMORY_INIT=y

# USB Debugging
#
CONFIG_PHY_EXYNOS_DEBUGFS=y
CONFIG_PHY_EXYNOS_DP_DEBUGFS=y
CONFIG_F_CONN_GADGET_DEBUGFS=y

#
# ABC Hub bootc eng mode
#
CONFIG_SEC_ABC_HUB_BOOTC_ENG=y

#
# LCD eng feature
#
CONFIG_EXYNOS_LCD_ENG=y
CONFIG_EXYNOS_DPU_SYSTRACE=y

# UH
# CONFIG_UH_LKM_BLOCK is not set
# CONFIG_KDP_CRED is not set
# CONFIG_KDP_NS is not set
# CONFIG_KDP_DMAP is not set
# CONFIG_RKP_TEST is not set
# CONFIG_KDP_TEST is not set

# HDM
CONFIG_HDM_DEBUG=y

# SDP KeyManagement Test for MDFPP evaluation
CONFIG_SDP_KEY_DUMP=y

#Displayport test
CONFIG_DISPLAYPORT_ENG=y

# BPF_debugging
CONFIG_BPF_TRACE_PRINTK_EVERYWHERE=y

# CONFIG_UH_RKP_FIMC_CHECK is not set
```

## arch/arm64/configs/exynos9830-kasan_defconfig
```kconfig
#
# Increase by 12kB because we increased KASAN_THREAD_SHIFT
# Required because of  https://bugs.llvm.org/show_bug.cgi?id=38809
#
CONFIG_FRAME_WARN=14336

#
# Enable multishot mode
# https://github.sec.samsung.net/SRPOL-SRUK-SEC/syzkaller/issues/23
#
CONFIG_CMDLINE="kasan_multi_shot"

#
# Kernel Performance Events and Counters
#
CONFIG_SLUB_DEBUG=y

#
# KASAN Kernel Address SANitizer
#
CONFIG_KASAN=y
CONFIG_KASAN_INLINE=y
CONFIG_LOG_BUF_SHIFT=21
CONFIG_CC_OPTIMIZE_FOR_SIZE=y

#
# Reduce kernel size because of bootloader memory map restriction
#
# CONFIG_RANDOMIZE_BASE is not set

#
#
# Undefined config for Kernel SANitizers
#
# CONFIG_UH is not set
# CONFIG_UH_RKP is not set
# CONFIG_RKP_CFP_JOPP is not set

#
# DO NOT REMOVE THE LAST BLANK LINE
#
```

## arch/arm64/configs/exynos9830-userdebug_defconfig
```kconfig
#
# please don't remove new line on this file
#

CONFIG_USE_SIGNED_BINARY=n

CONFIG_SEC_GPIO_DVS=y
CONFIG_G2D_SYSTRACE=y
CONFIG_CMUCAL_DEBUG=y
CONFIG_CRYPTO_DISKCIPHER_DEBUG=y
CONFIG_IKCONFIG=y
CONFIG_IKCONFIG_PROC=y
CONFIG_ARM_EXYNOS_DEVFREQ_DEBUG=y
CONFIG_EXYNOS_DPU_SYSTRACE=y

# streamline
CONFIG_PROFILING=y
CONFIG_PERF_EVENTS=y
CONFIG_HIGH_RES_TIMERS=y
CONFIG_HW_PERF_EVENTS=y
CONFIG_LOCAL_TIMERS=y

# CONFIG_GATOR is not set

# UH
# CONFIG_UH_LKM_BLOCK is not set
# CONFIG_KDP_CRED is not set
# CONFIG_KDP_NS is not set
# CONFIG_KDP_DMAP is not set
# CONFIG_RKP_TEST is not set
# CONFIG_KDP_TEST is not set

# SDP KeyManagement Test for MDFPP evaluation
CONFIG_SDP_KEY_DUMP=y

# BPF_debugging
CONFIG_BPF_TRACE_PRINTK_EVERYWHERE=y

# CONFIG_UH_RKP_FIMC_CHECK is not set
```

## drivers/battery/v2/Kconfig
```kconfig
#
# battery v2 configuration
#

config BATTERY_SAMSUNG_DC
	tristate "samsung battery driver for direct charging model"
	default n
	depends on DIRECT_CHARGING
	help
	 Say Y to include support for samsung battery driver
	 This battery driver integrated all battery-related functions
	 To see battery-related functions,
	 refer to sec_charging_common.h

config MULTI_CHARGING
	bool "support for multi charger ICs"
	help
	Say Y to include support for multi charger ICs

config STEP_CHARGING
	bool "support for step charging"
	help
	 Say Y to include support for step charging

config ENABLE_FULL_BY_SOC
	bool "make full by soc 100%"
	help
	default n
	 Say Y to include support to make full by soc 100%

config DIRECT_CHARGING
	bool "support for direct charging"
	help
	 Say Y to include support for direct charging

config UPDATE_BATTERY_DATA
	bool "support for updating battery data"
	default n
	depends on BATTERY_SAMSUNG && OF
	help
	 Say Y to include support for step charging

config AFC_CURR_CONTROL_BY_TEMP
	tristate "fast charging current control by temp"
	default n
	depends on BATTERY_SAMSUNG
	help
	 Say Y to set afc current control by temp

 config BATTERY_CISD
	 bool "support for cisd"
	 help
	 Say Y to include support for cisd
	 cisd means cell internal short detection

config WIRELESS_AUTH
	 bool "support for samsung wireless authentication massage"
	 help
	 Say Y to include support for swam
	 samsung wireless authentication massage 

# Fuel Gauge

config FUELGAUGE_DUMMY
	tristate "dummy fuel gauge driver"
	default n
	depends on BATTERY_SAMSUNG
	help
	 Say Y to include support
	 for dummy fuel gauge driver.
	 This driver source code implemented
	 skeleton source code for fuel gauge functions.

config FUELGAUGE_MAX77865
	tristate "MAX77865 fuel gauge driver"
	default n
	depends on BATTERY_SAMSUNG
	help
	 Say Y to include support
	 for MAXIM MAX77865 fuel gauge driver.
	 This fuel-gauge can be used in coulomb-counting mode.

config FUELGAUGE_MAX77705
	tristate "MAX77705 fuel gauge driver"
	default n
	depends on BATTERY_SAMSUNG
	help
	 Say Y to include support
	 for MAXIM MAX77705 fuel gauge driver.
	 This fuel-gauge can be used in coulomb-counting mode.

# Charger

config CHARGER_DUMMY
	tristate "dummy charger driver"
	default n
	depends on BATTERY_SAMSUNG
	help
	 Say Y to include support
	 for dummy charger driver.
	 This driver source code implemented
	 skeleton source code for charger functions.

config CHARGER_MAX77865
	tristate "MAX77865 battery charger support"
	depends on BATTERY_SAMSUNG
	help
	  Say Y here to enable support for the MAX77865 charger

config CHARGER_MAX77705
	tristate "MAX77705 battery charger support"
	depends on BATTERY_SAMSUNG
	help
	  Say Y here to enable support for the MAX77705 charger

config CHARGER_MAX77705_OTG_LIMIT
	bool "enable for controlling limitation"
	default n
	depends on CHARGER_MAX77705
	help
	  Say Y to control limitation

config MAX77705_CHECK_B2SOVRC
	bool "enable for check B2SOVRC"
	default n
	depends on CHARGER_MAX77705
	help
	  Say Y to check B2SOVRC

config CHARGER_PCA9468
	tristate "PCA9468 charger driver"
	default n
	depends on DIRECT_CHARGING
	help
	  Say Y here to enable support for the PCA9468 charger

config WIRELESS_CHARGER_HIGH_VOLTAGE
	tristate "high voltage wireless charger"
	depends on BATTERY_SAMSUNG && I2C
	help
	  Say Y here to enable support for the wireless charger charger
	  driver.

config WIRELESS_NO_HV
	tristate "wireless no hv"
	depends on BATTERY_SAMSUNG && I2C
	help
	  Say Y here to disable HV wireless charging
	  driver.

config CS100_JPNCONCEPT
	tristate "cs100 command support"
	depends on BATTERY_SAMSUNG && I2C
	help
	 Say Y here to support for CS100 command to stop when full-charged
	 on wireless charging for JPN models

config WIRELESS_CHARGER_BQ51221
        tristate "bq51221 battery charger support"
        depends on BATTERY_SAMSUNG && I2C
        help
          Say Y here to enable support for the bq51221 charger
          bq51221 wireless charger driver.

config WIRELESS_CHARGER_P9220
	tristate "p9220 battery charger support"
	depends on BATTERY_SAMSUNG && I2C
	help
	  Say Y here to enable support for the p9220 charger
	  p9220 wireless charger driver.

config WIRELESS_CHARGER_S2MIW03
	tristate "s2miw03 wireless battery charger support"
	depends on BATTERY_SAMSUNG && I2C
	help
	  Say Y here to enable support for the S2MIW03 charger
	  S2MIW03 wireless charger driver.

config WIRELESS_CHARGER_MFC
	tristate "MFC IC charger support"
	depends on BATTERY_SAMSUNG && I2C
	help
	  Say Y here to enable support for the MFC IC
	  MFC wireless charger driver.

config WIRELESS_FIRMWARE_UPDATE
	tristate "p9220 battery charger support"
	depends on BATTERY_SAMSUNG
	help
	  Say Y here to enable support for the wireless charger firmware update
	  wireless charger IC firmware update.

config WIRELESS_TX_MODE
	bool "wireless power sharing support in sec battery driver"
	default n
	depends on BATTERY_SAMSUNG
	help
	  Say Y to include support for sec afc charging support

config EN_OOPS
	bool "enable oops filter"
	default n
	help
	  Say Y to enable oops filter

config QH_ALGORITHM
       bool "enable QH algorithm"
       default n
       help
	 Say Y to enable CONFIG_QH_ALGORITHM

config BATTERY_NOTIFIER
	bool "battery notifier"
	default n
	help
	  Say Y to enable battery notifier

config CALC_WPC_TX_POWER
	bool "calculate how much power was used by wireless power sharing"
	help
	default n
	 Say Y to include support to calculate power consumption by wireless power sharing
```

## drivers/staging/sti/labo/Kconfig
```kconfig
comment "Samsung LABO Options"
config SEC_LABO
	bool "Samsung LABO Feature"
	depends on SEC_STI
	depends on SEC_FACTORY
	default y
	help
	  Samsung LABO Driver Feature
	  This driver is to support LABO APK
	  It depends on SEC_STI Feature
```

## kernel/ftt/Kconfig
```kconfig
config FAST_TRACK
    bool "ftt feature"
    default n
    help
      if set, ftt feature is enable
```
